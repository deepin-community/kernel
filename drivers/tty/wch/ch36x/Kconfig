## drivers/tty/wch/ch36x/Kconfig
```kconfig
config CH36X
	tristate "WCH ch36x driver"
	default m
	help
		Support for WCH ch36x drivers.
```

## drivers/tty/wch/ch9344ser/Kconfig
```kconfig
config CH9344SER
	tristate "WCH ch9344 serial driver"
	default m
	help
		Support for WCH ch9344 serial drivers.
```

## drivers/usb/phytium/Kconfig
```kconfig
config USB_PHYTIUM
	tristate "Phytium USB Support"
	depends on USB
	depends on USB_GADGET
	help
	  Say Y or M here if your system has a OTG USB Controller based on PHYTIUM SOC.
	  like Pe220x.

	  If you choose to build this driver is a dynamically linked modules, the module will
	  be called phytium-usb.ko

config USB_PHYTIUM_PCI
	tristate "Phytium PCI USB Support"
	default n
	depends on USB
	depends on USB_GADGET
	help
	  Say Y or M here if your system has a OTG USB Controller based on PHYTIUM SOC.
	  like Pe220x.

	  If you choose to build this driver is a dynamically linked modules, the module will
	  be called phytium-usb.ko
```

## drivers/virt/coco/csv-guest/Kconfig
```kconfig
config CSV_GUEST
	tristate "HYGON CSV Guest driver"
	default m
	depends on HYGON_CSV
	help
	  CSV firmware provides the guest a mechanism to communicate with
	  the PSP without risk from a malicious hypervisor who wishes to read,
	  alter, drop or replay the messages sent. The driver provides
	  userspace interface to communicate with the PSP to request the
	  attestation report and more.

	  If you choose 'M' here, this module will be called csv-guest.
```

## kernel/dma/phytium/Kconfig
```kconfig
# SPDX-License-Identifier: GPL-2.0-only

config PSWIOTLB
	bool "Phytium software IO TLB"
	select NEED_DMA_MAP_STATE
	depends on ARCH_PHYTIUM && NUMA
	help
	  This enables phytium software IO TLB. You can disable phytium software
	  IO TLB using "pswiotlb=forceoff" on the kernel command line if you do
	  not need it when PSWIOTLB is Y.
```

## security/hookmanager/Kconfig
```kconfig
config SECURITY_HOOKMANAGER
       bool "hookmanager support"
       depends on SECURITY
       depends on NET
       select SECURITYFS
       select SECURITY_PATH
       select SECURITY_NETWORK
       default y
       help
        This selects an hook manager for LSM hooks.
```
