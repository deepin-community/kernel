## drivers/infiniband/hw/zrdma/Kconfig
```kconfig
# SPDX-License-Identifier: GPL-2.0

config INFINIBAND_ZRDMA
        tristate "ZTE Ethernet Protocol Driver for RDMA"
        depends on NET_VENDOR_DINGHAI
        help
          Say Y or M here to enable support for the ZXDH ZRDMA RDMA device driver.

          If you choose to build this driver as a module, it will be built as
          a module named zrdma.
```

## drivers/net/ethernet/dinghai/Kconfig
```kconfig
config NET_VENDOR_DINGHAI
    tristate "Dinghai Devices"
    default m
    help
      If you have a Ethernet DINGHAI device belonging to this
          class, say m.

config DINGHAI_PF
    tristate "Dinghai PF Support"
    default m
    help
        Enable Dinghai PF Support

config DINGHAI_DH_CMD
    tristate "Dinghai DH_CMD Support"
    default m
    help
        Dinghai DH_CMD Support

config DINGHAI_NP
    tristate "Dinghai NP Support"
    default m
    help
      Enable Dinghai NP Support

config DINGHAI_PTP
    tristate "Dinghai PTP Support"
    default m
    depends on PTP_1588_CLOCK
    help
        Dinghai PTP Support

config DINGHAI_TSN
    tristate "Dinghai Support TSN"
    default m
    help
        Dinghai Support TSN Macro

config DINGHAI_AUXILIARY
       tristate "Dinghai AUXILIARY Support"
       default m
       help
         Enable Dinghai AUXILIARY Support
```

## drivers/net/ethernet/guangruntong/Kconfig
```kconfig
# SPDX-License-Identifier: GPL-2.0-only
#
# grt network device configuration
#

config NET_VENDOR_GRT
	bool "GuangRunTong(GRT) devices"
	default y
	help
	  If you have a network (Ethernet) card belonging to this class, say Y.

	  Note that the answer to this question doesn't directly affect the
	  kernel: saying N will just cause the configurator to skip all
	  the questions about GuangRunTong(GRT) cards. If you say Y, you will be asked for
	  your specific card in the following questions.

if NET_VENDOR_GRT

config GRTNIC_XGB
	tristate "GRT(R) 1-10GbE PCI Express adapters support"
	depends on PCI
	help
	  This driver supports GRT(R) 1-10GbE PCI Express family of
	  adapters.

	  To compile this driver as a module, choose M here. The module
	  will be called grtnic_xgb.

endif # NET_VENDOR_GRT
```

## drivers/net/ethernet/huawei/hinic3/Kconfig
```kconfig
# SPDX-License-Identifier: GPL-2.0-only
#
# Huawei driver configuration
#

config HINIC3
	tristate "Huawei Intelligent Network Interface Card 3rd"
	depends on PCI_MSI && NUMA && PCI_IOV && DCB
	depends on X86 || ARM64 || COMPILE_TEST
	help
	  This driver supports HiNIC PCIE Ethernet cards.
	  To compile this driver as part of the kernel, choose Y here.
	  If unsure, choose N.
	  The default is N.
```

## drivers/net/ethernet/phytium-pci-vnet/Kconfig
```kconfig
# SPDX-License-Identifier: GPL-2.0-only
#
# Phytium PCI virtual network device configuration
#

menu "Phytium PCI Virtual Ethernet Drivers"
config VNET_VENDOR_PHYTIUM
	bool "Phytium Virtual Ethernet devices"
	depends on ARCH_PHYTIUM
	depends on HAS_IOMEM
	default y
	help
	  If you have a network (Ethernet) card belonging to this class, say Y.

	  Note that the answer to this question doesn't directly affect the
	  kernel: saying N will just cause the configurator to skip all the
	  remaining Cadence network card questions. If you say Y, you will be
	  asked for your specific card in the following questions.

if VNET_VENDOR_PHYTIUM

source "drivers/net/ethernet/phytium-pci-vnet/pci-ep-net/Kconfig"
source "drivers/net/ethernet/phytium-pci-vnet/pci-rc-net/Kconfig"

endif #VNET_VENDOR_PHYTIUM
endmenu
```

## drivers/net/ethernet/phytium-pci-vnet/pci-ep-net/Kconfig
```kconfig
# SPDX-License-Identifier: GPL-2.0-only
#
# Phytium PCI EP virtual network device configuration
#

config PHYTIUM_PCI_EPF_VNET
	tristate "Phytium PCI Endpoint Virtual Ethernet Device"
	depends on PCI_ENDPOINT
	depends on PCIE_PHYTIUM_EP
	help
	  This option enables support for the Phytium PCI Endpoint Virtual Ethernet function
	  driver. It allows the device to appear as a network interface to a PCIe root complex.

	  Typically used in conjunction with a Phytium PCIe Root Complex host that supports
	  the corresponding RC virtual network function.

	  If you want this endpoint to provide virtual networking over PCIe, say Y or M.

	  If unsure, say N.
```

## drivers/net/ethernet/phytium-pci-vnet/pci-rc-net/Kconfig
```kconfig
# SPDX-License-Identifier: GPL-2.0-only
#
# Phytium PCI EP virtual network device configuration
#

config PHYTIUM_PCI_RC_VNET
	tristate "Phytium PCI Root Complex Virtual Ethernet Device"
	depends on PCI
	help
	  This driver provides support for a virtual Ethernet interface on the
	  Phytium PCIe Root Complex side. It is designed to work together with
	  a matching PCIe Endpoint function (such as PHYTIUM_PCI_EPF_VNET) to
	  enable Ethernet communication over PCIe links.

	  If you want to use the Root Complex side of the virtual network interface
	  over PCIe, say Y or M.

	  If unsure, say N.
```

## drivers/net/ethernet/xel/Kconfig
```kconfig
# SPDX-License-Identifier: GPL-2.0-only
#
# Xel network device configuration
#

config NET_VENDOR_XEL
	bool "Xel devices"
	default y
	help
	  If you have a network (Ethernet) card belonging to this class, say Y.

	  Note that the answer to this question doesn't directly affect the
	  kernel: saying N will just cause the configurator to skip all
	  the questions about Xel cards. If you say Y, you will be asked for
	  your specific card in the following questions.

if NET_VENDOR_XEL


config XLNID
	tristate "Xel(R) 82102/82101 PCI-Express Gigabit Ethernet adapters support"
	depends on PCI
	depends on PTP_1588_CLOCK_OPTIONAL
	select MDIO
	select PHYLIB
	help
	  This driver supports Xel(R) PCI Express family of
	  adapters.  For more information on how to identify your adapter, go
	  to the Adapter & Driver ID Guide that can be located at:

	  <http://www.xel-tech.com/>

	  To compile this driver as a module, choose M here. The module
	  will be called xlnid.

config XLNID_AUTO_MEDIA
	bool "Auto Media Support"
	default y
	depends on XLNID
	help
	  Say Y here if you want to use auto media in the driver.

	  If unsure, say Y.

endif # NET_VENDOR_XEL
```

## drivers/net/wireless/aic/aic8800_fdrv_m80x2p/Kconfig
```kconfig
# SPDX-License-Identifier: GPL-2.0-only
config AIC8800M80X2P_WLAN_SUPPORT
	tristate "AIC8800M80X2P WiFi support"
	depends on PCI && CFG80211
	help
	  This is support for AIC8800M80X2P WiFi driver.
	  It supports AICSemi AIC8800M80X2P based PCIe wireless
	  network adapters.

	  To compile this driver as a module, choose M here: the
	  module will be called aic8800_fdrv_m80x2p.
```

## drivers/perf/phytium/Kconfig
```kconfig
# SPDX-License-Identifier: GPL-2.0
menuconfig PHYTIUM_PMU
	bool "Phytium PMU support"
	help
	  Say Y here if you want to support Phytium performance monitoring
	  unit (PMU) drivers.

if PHYTIUM_PMU

config PHYT_DMU_PMU_PD2408
        tristate "Phytium PD2408 SoC DDR PMU driver"
        depends on (ARCH_PHYTIUM && ACPI && ARM_PHYTIUM_DMU_DEVFREQ) || COMPILE_TEST || (ARCH_PHYTIUM && ACPI && !ARM_PHYTIUM_DMU_DEVFREQ)
	default m
        help
          Provides support for Phytium PD2408 SoC DDR Controller performance
	  monitoring unit (PMU).

config PHYT_DDR_PMU
        tristate "Phytium SoC DDR PMU driver"
        depends on (ARCH_PHYTIUM && ACPI) || COMPILE_TEST
	default m
        help
          Provides support for Phytium SoC DDR Controller performance
	  monitoring unit (PMU).

config PHYT_PCIE_PMU
	tristate "Phytium SoC PCIE PMU driver"
	depends on (ARCH_PHYTIUM && ACPI) || COMPILE_TEST
	default m
	help
	  Provides support for Phytium SoC PCIe Controller performance
	  monitoring unit (PMU).

endif
```

## drivers/platform/arm64/Kconfig
```kconfig
# SPDX-License-Identifier: GPL-2.0-only

menuconfig ARM64_PLATFORM_DEVICES
	bool "ARM64 platform devices"
	depends on ARM64
	help
	  Say Y here to enable platform-specific drivers for ARM64 systems.
	  These drivers provide support for vendor-specific hardware that is
	  not covered by standard subsystem drivers, such as embedded
	  controllers, laptop hotkeys, backlight and power supply controls.

if ARM64_PLATFORM_DEVICES

config PHYTIUM_EC
	bool "Phytium IT8528 Embedded Controller support"
	depends on PHYTIUM_PIO
	help
	  Enable support for the IT8528 Embedded Controller found on some
	  Phytium laptop platforms. This driver communicates with the EC
	  over the Phytium PIO (Programmed I/O) path and is required by the
	  Phytium laptop driver for battery, lid and hotkey support.

config PHYTIUM_LAPTOP
	bool "Phytium laptop platform support"
	depends on PHYTIUM_EC
	select POWER_SUPPLY
	select BACKLIGHT_CLASS_DEVICE
	select INPUT_SPARSEKMAP
	select HWMON
	help
	  Enable laptop-specific support for Phytium platforms. This
	  provides power-supply reporting (AC and battery), backlight
	  control, lid status and Fn hotkey handling through the IT8528
	  embedded controller.

endif
```

## drivers/scsi/hisi_raid/Kconfig
```kconfig
#
# Kernel configuration file for the hisi_raid
#

config SCSI_HISI_RAID
	tristate "Huawei Hisi_Raid Adapter"
	depends on PCI && SCSI
	select BLK_DEV_BSGLIB
	depends on ARM64 || X86_64 || COMPILE_TEST
	help
	This driver supports hisi_raid SPxx serial RAID controller, which has
	PCI Express Gen4 interface with host and supports SAS/SATA HDD/SSD.
	To compile this driver as a module, choose M here: the module will
	be called hisi_raid.
```

## drivers/soc/cix/Kconfig
```kconfig
# SPDX-License-Identifier: GPL-2.0-only
menu "Cix Dst drivers"

config SOC_CIX
	bool "Cix Sky SoC family support"
	depends on ARM64 || COMPILE_TEST
	default n
	help
	  If you say yes here you get support for the Cix sky family
	  support, it will provide the SoC info like SoC family,
	  ID and revision etc.

config CIX_SKY1_SOCINFO
	bool "Cix Sky1 SoC Information driver"
	depends on ARM64 || COMPILE_TEST
	select SOC_BUS
	help
	  Say yes to support decoding of CIX Sky1 SoC family information
	  about the type and version.

config CIX_SOC_ACPI
	bool "Cix SoC ACPI drivers"
	depends on ARM64 || COMPILE_TEST
	depends on ACPI
	select SOC_BUS
	help
	  Say yes to support CIX SoC ACPI drivers.

endmenu
```

## drivers/soc/cix/gpu/arm/midgard/platform/sky1/Kconfig
```kconfig
# SPDX-License-Identifier: GPL-2.0-only
config MALI_CIX_POWER_MODEL
	bool "Enable CIX GPU power model"
	depends on MALI_MIDGARD
	default y
	help
	  Enables support for CIX GPU power model.
```

## drivers/soc/cix/scmi/Kconfig
```kconfig
# SPDX-License-Identifier: GPL-2.0-only
menu "CIX SCMI Extension"

config ARM_SCMI_PROTOCOL
	tristate "ARM System Control and Management Interface (SCMI) Message Protocol"
	depends on ARM || ARM64 || COMPILE_TEST
	help
	  ARM System Control and Management Interface (SCMI) protocol is a
	  set of operating system-independent software interfaces that are
	  used in system management. SCMI is extensible and currently provides
	  interfaces for: Discovery and self-description of the interfaces
	  it supports, Power domain management which is the ability to place
	  a given device or domain into the various power-saving states that
	  it supports, Performance management which is the ability to control
	  the performance of a domain that is composed of compute engines
	  such as application processors and other accelerators, Clock
	  management which is the ability to set and inquire rates on platform
	  managed clocks and Sensor management which is the ability to read
	  sensor data, and be notified of sensor value.

	  This protocol library provides interface for all the client drivers
	  making use of the features offered by the SCMI.

if ARM_SCMI_PROTOCOL

config ARM_SCMI_TRANSPORT_MAILBOX
	bool "SCMI transport based on Mailbox"
	depends on MAILBOX
	select ARM_SCMI_HAVE_TRANSPORT
	select ARM_SCMI_HAVE_SHMEM
	help
	  Enable mailbox based transport for SCMI.

	  If you want the ARM SCMI PROTOCOL stack to include support for a
	  transport based on mailboxes, answer Y.

endif #ARM_SCMI_PROTOCOL

endmenu
```

## drivers/soc/cix/vpu/driver/Kconfig
```kconfig
config VIDEO_LINLON
	tristate "Linlon VPU support."
	depends on VIDEO_DEV
	default m
	help
	  This enables support for the Linlon VPU family.

config VIDEO_LINLON_FTRACE
	depends on VIDEO_LINLON
	bool "Send kernel space logs to ftrace."
	default n
	help
		Send kernel space logs to ftrace.

config VIDEO_LINLON_PRINT_FILE
	depends on VIDEO_LINLON
	bool "Append file and line number to kernel space log messages."
	default y
	help
		Append file and line number to kernel space log messages.
```

## drivers/staging/phytium-npu/Kconfig
```kconfig
# SPDX-License-Identifier: GPL-2.0
menuconfig PHYTIUM_NPU
    tristate "Phytium neural network processing unit"
	depends on ARCH_PHYTIUM
	help
	  Say Y here if your want support for Phytium NPU controller framework.
	  This is common support for devices that embed the Phytium NPU IP.

	  To compile this driver as a module, choose M here: the module will be
	  called phytium_npu.

if PHYTIUM_NPU
choice
	prompt "Select the Phytium NPU Hardware"
	default y
	help
	  You need to select a suitable NPU controller in the current board.
	  This option allows you to decide which Phytium NPU will be built
	  in system.
	  If in doubt, select 'N'
	config NPU_PLATFORM
		tristate "driver runs on platform"
	help
	  Say Y here if you want to support for IO Mapped Phytium NPU controller.
	  This support is for devices that have the Phytium NPU controller IP.
	  To compile this driver as a module, choose M here: the module will be
	  called phytium_npu_platform.
	config NPU_PCI
		tristate "driver runs on PCI hardware"
	help
	  Say Y here if you want to support for Phytium NPU controller connected
	  to the PCI bus. This support is for devices that have the Phytium NPU
	  controller IP embedded into a PCI device.
	  To compile this driver as a module, choose M here: the module will be
	  called phytium_npu_pci.
endchoice
endif
```

## drivers/uos/Kconfig
```kconfig
# SPDX-License-Identifier: GPL-2.0
menu "UOS Driver config"

source "drivers/uos/phyt/Kconfig"
endmenu
```

## drivers/uos/phyt/Kconfig
```kconfig
menuconfig UOS_PHYTIUM_DESKTOP_SUPPORT
	bool "phytium desktop drivers/fixups provided by UOS"
	default n
	help
	  This option enables a collection of UOS-supplied drivers and
	  quirks for Phytium desktop and laptop platforms.  These drivers
	  are not part of the standard upstream kernel and should only be
	  enabled when running on supported Phytium systems.

if UOS_PHYTIUM_DESKTOP_SUPPORT

config PHYTIUM_EC
	bool "phytium ec support"
	depends on PHYTIUM_PIO
	default n
	help
	  Enable support for the IT8528 Embedded Controller found on some
	  Phytium laptop platforms.  This driver communicates with the EC
	  over the Phytium PIO (Programmed I/O) path and is required by the
	  Phytium laptop driver for battery, lid and hotkey support.

config PHYTIUM_LAPTOP
	bool "phytium laptop support"
	depends on PHYTIUM_EC
	select POWER_SUPPLY
	select BACKLIGHT_CLASS_DEVICE
	select INPUT_SPARSEKMAP
	select HWMON
	help
	  Enable laptop-specific support for Phytium platforms.  This
	  provides power-supply reporting (AC and battery), backlight
	  control, lid status and Fn hotkey handling through the IT8528
	  embedded controller.

endif
```
