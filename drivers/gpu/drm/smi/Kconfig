## drivers/gpu/drm/smi/Kconfig
```kconfig
config DRM_SMI
        tristate "SiliconMotion SM750/SM768 DRM driver"
        depends on DRM && PCI
        select DRM_VRAM_HELPER
        select DRM_KMS_HELPER
        help
         Say yes for SiliconMotion SM750/SM768 DRM driver.
         

config DRM_SMI_HDMI
        bool "Enable SM750 HDMI output"
        depends on DRM_SMI
        help
          Compile in support for SM750 HDMI output(Using Sil9022).


config DRM_SMI_PRIME
        bool "enable SMI PRIME"
        depends on DRM_SMI
        help
          Compile in support for PRIME(Mulit-card).
```

## drivers/gpu/drm/smidrm/Kconfig
```kconfig
# SPDX-License-Identifier: GPL-2.0-only
config DRM_SMI
	tristate "SiliconMotion SM750/SM768/SM770 DRM driver"
	depends on DRM && PCI && MMU
    	select DRM_CLIENT_SELECTION
	select DRM_GEM_SHMEM_HELPER
	select DRM_KMS_HELPER
	select SND_PCM
	help
		Say yes for SiliconMotion SM750/SM768/SM770 DRM driver.
```

## drivers/iommu/sw64/Kconfig
```kconfig
# SPDX-License-Identifier: GPL-2.0-only
# SW64 IOMMU SUPPORT
config SUNWAY_IOMMU
	bool "Sunway IOMMU Support"
	select IOMMU_API
	select IOMMU_IOVA
	select IOMMU_DMA
	depends on SW64 && PCI && SUBARCH_C3B
	help
	  Support for IOMMU on SW64 platform. It can enable or bypass specific device by
	  adding boot param "sunway_iommu" and "iommu.passthrough".

# SW64 IOMMU V2 SUPPORT
config SUNWAY_IOMMU_V2
	bool "Sunway IOMMU V2 Support"
	select IOMMU_API
	select IOMMU_IOVA
	select IOMMU_DMA
	depends on SW64 && PCI && SUBARCH_C4
	help
	  Support for IOMMU V2 on SW64 platform. It can enable or bypass specific device by
	  adding boot param "sunway_iommu" and "iommu.passthrough".
```

## drivers/media/platform/phytium/Kconfig
```kconfig
# SPDX-License-Identifier: GPL-2.0-only

comment "Phytium media platform drivers"

config VIDEO_PHYTIUM_JPEG
	tristate "Phytium JPEG Encoder Engine driver"
	depends on V4L_PLATFORM_DRIVERS
	depends on VIDEO_DEV
	select VIDEOBUF2_DMA_CONTIG
	help
	  Support for the Phytium JPEG Encoder Engine embedded
	  in the Phytium SOCs. The engine can capture and
	  compress video data from digital or analog sources.
```

## drivers/net/ethernet/3snic/Kconfig
```kconfig
# SPDX-License-Identifier: GPL-2.0
#
# 3SNIC network device configuration
#

config NET_VENDOR_3SNIC
	bool "3SNIC smart NIC devices"
	depends on PCI
	select NET_DEVLINK
	help
	  If you have a network (Ethernet) card belonging to this class, say Y.

	  Note that the answer to this question doesn't directly affect the
	  kernel: saying N will just cause the configurator to skip all
	  the questions about 3SNIC cards. If you say Y, you will be
	  asked for your specific card in the following questions.

if NET_VENDOR_3SNIC

source "drivers/net/ethernet/3snic/sssnic/Kconfig"

endif # NET_VENDOR_3SNIC
```

## drivers/net/ethernet/3snic/sssnic/Kconfig
```kconfig
# SPDX-License-Identifier: GPL-2.0
#
# 3SNIC network device configuration
#

config SSSNIC
	tristate "3SNIC Ethernet Controller SSSNIC Support"
	depends on PCI
	depends on ARM64 || X86_64
	help
	  This driver supports 3SNIC Ethernet Controller SSSNIC device.
	  For more information about this product, go to the product
	  description with smart NIC:

	  <http://www.3snic.com>

	  To compile this driver as a module, choose M here. The module
	  will be called sssnic.
```

## drivers/net/ethernet/bzwx/Kconfig
```kconfig
# SPDX-License-Identifier: GPL-2.0-only
#
# BeiZhongWangXin device configuration
#

config NET_VENDOR_BZWX
	bool "BeiZhongWangXin devices"
	default y
	help
	  If you have a network (Ethernet) card belonging to this class, say Y.

	  Note that the answer to this question doesn't directly affect the
	  kernel: saying N will just cause the configurator to skip all
	  the questions about BeiZhongWangXin devices. If you say Y, you will be asked
	  for your specific device in the following questions.

if NET_VENDOR_BZWX

source "drivers/net/ethernet/bzwx/nce/Kconfig"

endif # NET_VENDOR_BZWX
```

## drivers/net/ethernet/bzwx/nce/Kconfig
```kconfig
# SPDX-License-Identifier: GPL-2.0-only
#
# BeiZhongWangXin device configuration


config NCE
	tristate "BeiZhongWangXin Ethernet Connection N5/N6 Series Support"
	depends on PCI
	help
	  This selects the drivers support BeiZhongWangXin Ethernet Connection N5/N6 Series devices.

if NCE

config NE6X
	tristate "BeiZhongWangXin Ethernet Connection N5/N6 Series Support"
	depends on (PCI_MSI && NETDEVICES && ETHERNET && INET && (X86_64 || ARM64))
	select NET_DEVLINK
	help
	  This driver supports BeiZhongWangXin Ethernet Connection N5/N6 Series
	  of devices.

	  To compile this driver as a module, choose M here.
	  The module will be called ncepf.

config NE6XVF
	tristate "BeiZhongWangXin Ethernet Connection N5/N6 Series Virtual Function support"
	depends on NE6X
	help
	  This driver supports virtual functions for BeiZhongWangXin Ethernet Connection N5/N6 Series
	  Virtual Function devices.

	  To compile this driver as a module, choose M here. The module
	  will be called ncevf.

endif #NCE
```

## drivers/net/ethernet/linkdata/Kconfig
```kconfig
# SPDX-License-Identifier: GPL-2.0-only
#
# Linkdata network device configuration
#

config NET_VENDOR_LINKDATA
	bool "Linkdata devices"
	default y
	help
	  If you have a network (Ethernet) card from Linkdata, say Y.

	  Note that the answer to this question doesn't directly affect the
	  kernel: saying N will just cause the configurator to skip all
	  the questions about Intel cards. If you say Y, you will be asked for
	  your specific card in the following questions.

if NET_VENDOR_LINKDATA
source "drivers/net/ethernet/linkdata/sxe/Kconfig"
source "drivers/net/ethernet/linkdata/sxevf/Kconfig"
endif # NET_VENDOR_LINKDATA
```

## drivers/net/ethernet/linkdata/sxe/Kconfig
```kconfig
# SPDX-License-Identifier: GPL-2.0-only
#
# sxe network device configuration
#

config SXE
	tristate "sxe PCI Express adapters support"
	depends on PCI
	select MDIO
        select PHYLIB
        select PTP_1588_CLOCK
	help
	  This driver supports sxe PCI Express family of adapters.

	  To compile this driver as a module, choose M here. The module
	  will be called ngbe.
```

## drivers/net/ethernet/motorcomm/Kconfig
```kconfig
# SPDX-License-Identifier: GPL-2.0-only
# Copyright (c) 2023 Motorcomm, Inc.

config NET_VENDOR_MOTORCOMM
	bool "Motorcomm devices"
	default y
	depends on PCI
	help
	  If you have a network (Ethernet) card belonging to this class, say Y.

	  Note that the answer to this question doesn't directly affect the
	  kernel: saying N will just cause the configurator to skip all
	  the questions about Motorcomm cards. If you say Y, you will be asked
	  for your specific card in the following questions.

if NET_VENDOR_MOTORCOMM

config YT6801
	tristate "Motorcomm YT6801 Ethernet support"
	depends on PCI
	help
	  If you have a network (Ethernet) controller of this type, say Y here.

	  To compile this driver as a module, choose M here. The module
	  will be called forcedeth.

endif # NET_VENDOR_MOTORCOMM
```

## drivers/net/ethernet/mucse/Kconfig
```kconfig
# SPDX-License-Identifier: GPL-2.0-only
# 
# Mucse network device configuration
#

config NET_VENDOR_MUCSE
        bool "Mucse devices"
        default y
        help
          If you have a network (Ethernet) card belonging to this class, say Y.

          Note that the answer to this question doesn't directly affect the
          kernel: saying N will just cause the configurator to skip all
          the questions about Mucse cards. If you say Y, you will be asked for
          your specific card in the following questions.


if NET_VENDOR_MUCSE

config MGBE
	tristate "Mucse(R) 1GbE PCI Express adapters support"
        depends on PCI
        imply PTP_1588_CLOCK
        help
          This driver supports Mucse(R) 1GbE PCI Express family of
          adapters. 

          To compile this driver as a module, choose M here. The module
          will be called rnp.

config MGBE_OPTM_WITH_LPAGE
	bool "Reduce Memory Cost In Large PAGE_SIZE(>8192)"
	default n
	depends on MGBE
	help
          Say Y here if you want to reduce memory cost in large PAGE_SIZE.

          If unsure, say N.

config MGBE_MSIX_COUNT
	int "Number of msix count"
	default "26"
	depends on MGBE
        help
          MXGBE range [2,26].

config MXGBE
	tristate "Mucse(R) 1/10/25/40GbE PCI Express adapters support"
        depends on PCI
        imply PTP_1588_CLOCK
        help
          This driver supports Mucse(R) 1/10/25/40GbE PCI Express family of
          adapters.

          To compile this driver as a module, choose M here. The module
          will be called rnp.

config MXGBE_FIX_VF_QUEUE
        bool "Fix VF Queue Used(pf)"
        default y
        depends on MXGBE
        help
          Say Y here if you want to fix vf queue order in the driver.

          If unsure, say N.

config MXGBE_FIX_MAC_PADDING
	bool "Close Mac Padding Function(pf)"
	default y
        depends on MXGBE
        help
          Say Y here if you want to fix close mac padding in the driver.

          If unsure, say N.

config MXGBE_OPTM_WITH_LARGE
	bool "Reduce Memory Cost In Large PAGE_SIZE(>8192)"
	default n
        depends on MXGBE
        help
          Say Y here if you want to reduce memory cost in large PAGE_SIZE.

          If unsure, say N.

config MXGBE_MSIX_COUNT
	int "Number of msix count"
	default "64"
	depends on MXGBE
        help
          MXGBE range [2,64].

config MXGBE_DCB
        bool "Data Center Bridging (DCB) Support"
        default y
        depends on MXGBE && DCB
        help
          Say Y here if you want to use Data Center Bridging (DCB) in the
          driver.

          If unsure, say N.

endif # NET_VENDOR_MUCSE
```

## drivers/net/ethernet/realtek/r8125/Kconfig
```kconfig
config R8125
	tristate "RealTek RTL8125 2.5Gigabit Ethernet controllers"
	help
	  RealTek RTL8125 2.5Gigabit Ethernet controllers with PCI-Express interface.
```

## drivers/net/ethernet/wangxun/Kconfig
```kconfig
# SPDX-License-Identifier: GPL-3.0-only
#
# Netswift network device configuration
#

config NET_VENDOR_WANGXUN
	bool "Wangxun devices"
	default y
	help
	  If you have a network (Ethernet) card belonging to this class, say Y.

	  Note that the answer to this question doesn't directly affect the
	  kernel: saying N will just cause the configurator to skip all
	  the questions about Intel cards. If you say Y, you will be asked for
	  your specific card in the following questions.

if NET_VENDOR_WANGXUN

config NGBE
	tristate "Netswift(R) GbE PCI Express adapters support"
	depends on PCI
	select MDIO
	select PHYLIB
	imply PTP_1588_CLOCK
	help
	  This driver supports Netswift(R) GbE PCI Express family of
	  adapters.  For more information on how to identify your adapter, go
	  to the Adapter & Driver ID Guide that can be located at:
config TXGBE
	tristate "Netswift(R) 10GbE PCI Express adapters support"
	depends on PCI
	select MDIO
	select PHYLIB
	imply PTP_1588_CLOCK
	help
	  This driver supports Netswift(R) 10GbE PCI Express family of
	  adapters.  For more information on how to identify your adapter, go
	  to the Adapter & Driver ID Guide that can be located at:

config NGBEVF
	tristate "Netswift(R) GbE PCI Express Virtual Function Ethernet support"
	help
	  This driver supports Netswift(R) PCI Express virtual functions for the
	  Netswift(R) ngbevf driver.  For more information on how to identify your
	  adapter, go to the Adapter & Driver ID Guide that can be located at:

config TXGBEVF
	tristate "Netswift(R) 10GbE PCI Express Virtual Function Ethernet support"
	help
	  This driver supports Netswift(R) PCI Express virtual functions for the
	  Netswift(R) txgbevf driver.  For more information on how to identify your
	  adapter, go to the Adapter & Driver ID Guide that can be located at:
endif # NET_VENDOR_WANGXUN
```

## drivers/net/wireless/mediatek/mt7920e/Kconfig
```kconfig
config MT7961
	tristate "Mediatek 7961 PCIE WiFi"
	depends on PCI
	help
	  Help message of MT7961, wlan_mt7961_pcie.ko
```

## drivers/pinctrl/ultrarisc/Kconfig
```kconfig
# SPDX-License-Identifier: GPL-2.0-only

config PINCTRL_ULTRARISC
	bool
	depends on OF
	select PINMUX
	select GENERIC_PINCTRL_GROUPS
	select GENERIC_PINCONF
	select GENERIC_PINMUX_FUNCTIONS
	select GPIOLIB
	select IRQ_DOMAIN_HIERARCHY
	select MFD_SYSCON

config PINCTRL_ULTRARISC_DP1000
	tristate "Pinctrl driver of UltraRisc DP1000"
	select PINCTRL_ULTRARISC
	depends on OF && HAS_IOMEM
	help
	  This driver configures the UltraRisc DP1000 SoC's pinctrl
	  subsystem.
```

## drivers/pinctrl/zhaoxin/Kconfig
```kconfig
# SPDX-License-Identifier: GPL-2.0
# Intel pin control drivers

if (X86 || COMPILE_TEST)

config PINCTRL_ZHAOXIN
	tristate
	select PINMUX
	select PINCONF
	select GENERIC_PINCONF
	select GPIOLIB
	select GPIOLIB_IRQCHIP

config PINCTRL_KX7000
	tristate "Zhaoxin KX7000 pinctrl and GPIO driver"
	depends on ACPI
	select PINCTRL_ZHAOXIN
	help
	  This pinctrl driver provides an interface that allows configuring
	  of Zhaoxin KX7000 chipset pins and using them as GPIOs.

endif
```

## drivers/platform/loongarch/Kconfig
```kconfig
#
# LoongArch Platform Specific Drivers
#

menuconfig LOONGARCH_PLATFORM_DEVICES
	bool "LoongArch Platform Specific Device Drivers"
	default y
	depends on LOONGARCH
	help
	  Say Y here to get to see options for device drivers of various
	  LoongArch platforms, including vendor-specific laptop/desktop
	  extension and hardware monitor drivers. This option itself does
	  not add any kernel code.

	  If you say N, all options in this submenu will be skipped and disabled.

if LOONGARCH_PLATFORM_DEVICES

config CPU_HWMON
	bool "Loongson CPU HWMon Driver"
	depends on MACH_LOONGSON64
	select HWMON
	default y
	help
	  Loongson-3A/3B/3C CPU HWMon (temperature sensor) driver.

config LOONGSON_LAPTOP
	tristate "Generic Loongson-3 Laptop Driver"
	depends on ACPI
	depends on BACKLIGHT_CLASS_DEVICE
	depends on INPUT
	depends on MACH_LOONGSON64
	select ACPI_VIDEO
	select INPUT_SPARSEKMAP
	default y
	help
	  ACPI-based Loongson-3 family laptops generic driver.

endif # LOONGARCH_PLATFORM_DEVICES
```

## drivers/scsi/ps3stor/Kconfig
```kconfig
# SPDX-License-Identifier: GPL-2.0-only
#
# Linkdata network device configuration
#

config SCSI_LINKDATA_PS3STOR
	tristate "Linkdata ps3stor RAIDHBA card"
	depends on PCI && SCSI
	depends on SCSI_FC_ATTRS
	select FW_LOADER
	help
	  This driver support Linkdata ps3stor RAIDHBA card.

	  To compile this driver as a module choose M here; the module
	  will be called ps3stor.
```

## drivers/scsi/sssraid/Kconfig
```kconfig
#
# Kernel configuration file for the 3SNIC
#

config SCSI_3SNIC_SSSRAID
	tristate "3SNIC sssraid Adapter"
	depends on PCI && SCSI
	select BLK_DEV_BSGLIB
	depends on ARM64 || X86_64
	help
	This driver supports 3SNIC 3S5xx serial RAID controller, which has
	PCI Express Gen4 interface with host and supports SAS/SATA HDD/SSD.
	To compile this driver as a module, choose M here: the module will
	be called sssraid.
```
