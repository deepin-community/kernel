## Documentation/devicetree/bindings/edac/phytium,pe220x-edac.yaml
```yaml
# SPDX-License-Identifier: GPL-2.0-only OR BSD-2-Clause
%YAML 1.2
---
$id: http://devicetree.org/schemas/edac/phytium,pe220x-edac.yaml
$schema: http://devicetree.org/meta-schemas/core.yaml#

title: Phytium Pe220x SoC EDAC node
maintainers:
  - Zhu Honglei <zhuhonglei1714@phytium.com.cn>

description: |
        EDAC node is defined to describe on-chip error detection and correction.

properties:
  compatible:
    const: phytium,pe220x-edac

  reg:
    maxItems: 3

  interrupts:
    minItems: 2
    items:
      - description: Interrupt-specifier for RAS error IRQ(s).

required:
  - compatible: Shall be "phytium,pe220x-edac".
  - reg: Shall be the Pe220x RAS resource.
  - interrupts: Interrupt-specifier for RAS error IRQ(s).

examples:
  - |
	edac: edac@32b28000 {
		compatible = "phytium,pe220x-edac";
		reg = <0x0 0x32b28000 0x0 0x1000>,
			<0x0 0x31400000 0x0 0x1000>,
			<0x0 0x31401000 0x0 0x1000>;
		interrupts = <GIC_SPI 0 IRQ_TYPE_LEVEL_HIGH>,
				<GIC_SPI 1 IRQ_TYPE_LEVEL_HIGH>,
	};
```

## Documentation/devicetree/bindings/gpio/gpio-phytium.txt
```
* Phytium GPIO controller

Required properties:
- compatible : Should contain "phytium,gpio"
- reg : Address and length of the register set for the device.
- interrupts: Interrupt mapping for GPIO IRQ.
- gpio-controller : Marks the device node as a gpio controller.
- #gpio-cells : Should be 2. The first cell is the pin number and
  the second cell is used to specify the gpio polarity:
      0 = active high
      1 = active low
- #address-cells : should be 1 (for addressing port subnodes).
- #size-cells : should be 0 (port subnodes).

The GPIO controller has two ports, each of which are represented as child
nodes with the following properties:

Required properties:
- compatible : "phytium,gpio-port"
- reg : The integer port index of the port, a single cell.

Optional properties:
- nr-gpios : The number of pins in the port, a single cell.

Example:

gpio: gpio@28004000 {
	compatible = "phytium,gpio";
	reg = <0x0 0x28004000 0x0 0x1000>;
	interrupts = <GIC_SPI 10 IRQ_TYPE_LEVEL_HIGH>;
	gpio-controller;
	#gpio-cells = <2>;
	#address-cells = <1>;
	#size-cells = <0>;

	porta {
		compatible = "phytium,gpio-port";
		reg = <0>;
		nr-gpios = <8>;
	};

	portb {
		compatible = "phytium,gpio-port";
		reg = <1>;
		nr-gpios = <8>;
	};
};
```

## Documentation/devicetree/bindings/gpio/phytium,sgpio.yaml
```yaml
# SPDX-License-Identifier: (GPL-2.0 OR BSD-2-Clause)
%YAML 1.2
---
$id: http://devicetree.org/schemas/gpio/phytium,sgpio.yaml#
$schema: http://devicetree.org/meta-schemas/core.yaml#

title: Phytium SGPIO controller

description: |
  This SGPIO controller is for Phytium Pe220x SoCs, which supports up to
  96 (32x3) Serial GPIOs.

maintainers:
  - Chen Baozi <chenbaozi@phytium.com.cn>

properties:
  compatible:
    const: phytium,sgpio

  reg:
    maxItems: 1
    description: Address and length of the register set for the device.

  gpio-controller: true

  '#gpio-cells':
    const: 2
    description: |
      The first cell is the pin number and the second cell is used to specify
      the gpio polarity.
        0 = active high
        1 = active low

  interrupts:
    maxItems: 1

  ngpios: true

  bus-frequency: true

  clocks:
    maxItems: 1

additionalProperties: false

required:
  - compatible
  - reg
  - gpio-controller
  - '#gpio-cells'
  - interrupts
  - ngpios
  - clocks
  - bus-frequency

examples:
  - |
    sgpio: sgpio@2807d000 {
      compatible = "phytium,sgpio";
      reg = <0x0 0x2807d000 0x0 0x1000>;
      interrupts = <GIC_SPI 190 IRQ_TYPE_LEVEL_HIGH>;
      clocks = <&sysclk_48mhz>;
      ngpios = <96>;
      bus-frequency = <48000>;
      gpio-controller;
      #gpio-cells = <2>;
    };
```

## Documentation/devicetree/bindings/gpu/phytium,dc.yaml
```yaml
# SPDX-License-Identifier: (GPL-2.0 OR BSD-2-Clause)
%YAML 1.2
---
$id: http://devicetree.org/schemas/sound/phytium,dc.yaml#
$schema: http://devicetree.org/meta-schemas/core.yaml#

title: Phytium Display Controller

maintainers:
  - Dai Jingtao <daijingtao1503@phytium.com.cn>

properties:
  compatible:
    enum:
      - phytium,dc

  reg:
    items:
      - description: DC registers

  interrupts:
    maxItems: 1

required:
  - compatible
  - reg
  - interrupts

examples:
  - |
    dc@32000000 {
        compatible = "phytium,dc";
        reg = <0x0 0x32000000 0x0 0x8000>;
        interrupts = <GIC_SPI 44 IRQ_TYPE_LEVEL_HIGH>;
    };
```

## Documentation/devicetree/bindings/hwlock/phytium,hwspinlock.yaml
```yaml
# SPDX-License-Identifier: (GPL-2.0-only or BSD-2-Clause)
%YAML 1.2
---
$id: http://devicetree.org/schemas/hwlock/phytium,hwspinlock.yaml#
$schema: http://devicetree.org/meta-schemas/core.yaml#

title: Phytium HwSpinlock Driver

maintainers:
  - Chen Baozi <chenbaozi@phytium.com.cn>

properties:
  compatible:
    const: phytium,hwspinlock

  reg:
    maxItems: 1
    description: Contains the hwspinlock module register address space.

  "#hwlock-cells":
    const: 1
    description: |
      The Phytium hwspinlock users will use a 0-indexed relative hwlock number as
      the argument specifier value for requesting a specific hwspinlock within
      a hwspinlock bank.

      Please look at the generic hwlock binding for usage information for
      consumers, "Documentation/devicetree/bindings/hwlock/hwlock.txt"

  nr-locks:
    $ref: /schemas/types.yaml#/definitions/uint32
    description: The number of locks in the device.

required:
  - compatible
  - reg
  - "#hwlock-cells"
  - nr-locks

additionalProperties: false

examples:

  - |
    hwspinlock: spinlock@40000000 {
      compatible = "phytium,hwspinlock";
      reg = <0x40000000 0x1000>;
      #hwlock-cells = <1>;
      nr-locks = <32>;
    };
```

## Documentation/devicetree/bindings/hwmon/phytium,tacho.yaml
```yaml
# SPDX-License-Identifier: (GPL-2.0-only OR BSD-2-Clause)
%YAML 1.2
---
$id: http://devicetree.org/schemas/hwmon/phytium,tacho.yaml
$schema: http://devicetree.org/meta-schemas/core.yaml#

title: Phytium Fan Tacho and capture counter controller device driver

maintainers:
  - Chen Baozi <chenbaozi@phytium.com.cn>

description: |
  The controller can support one input signal. The function of controller is to
  measure the speed of fan and the edge number of input signal. The function
  can be selected by devicetree setting. The edging mode and anti-jitter level
  can also setted in devicetree.

properties:
  compatible:
    const: phytium,tacho

  reg:
    maxItems: 1

  clocks:
    maxItems: 1

  '#address-cells':
    const: 1

  '#size-cells':
    const: 1

  tacho:
    $ref: /schemas/types.yaml#/definitions/flag
    description:
      set the controller work as fan tachometer, which is a default option.

  capture:
    $ref: /schemas/types.yaml#/definitions/flag
    description:
      set the controller work as capture counter.

  up:
    $ref: /schemas/types.yaml#/definitions/flag
    description:
      set the input edging mode as ascending, which is a default option.

  down:
    $ref: /schemas/types.yaml#/definitions/flag
    description:
      set the input edging mode as descending.

  double:
    $ref: /schemas/types.yaml#/definitions/flag
    description:
      set the input edging mode as doule-edging.

  debounce-level:
    $ref: /schemas/types.yaml#/definitions/uint32
    enum: [0, 1, 2, 3]

required:
  - compatible
  - reg
  - clocks
  - '#address-cells'
  - '#size-cells'

examples:
  - |
    tacho: tacho@28054000 {
      #address-cells = <1>;
      #size-cells = <1>;
      reg = <0x0 0x28054000 0x0 0x1000>;
      compatible = "phytium,tacho";
      clocks = <&sysclk>;
      tacho;
      up;
      debounce-level = <2>;
    };
```

## Documentation/devicetree/bindings/i3c/phytium,i3c-master.yaml
```yaml
# SPDX-License-Identifier: GPL-2.0-only OR BSD-2-Clause

* Phytium I3C controller

This I3C controller is for Phytium Soc.

Required properties:
- compatible: Shall be "phytium,cdns-i3c-master"
- clocks: Shall reference the pclk and sysclk
- clock-names: Shall contain "pclk" and "sysclk"
- interrupts: The interrupt line connected to this I3C master
- reg: I3C master registers
- #address-cells: Shall be set to 1
- #size-cells: Shall be set to 0
- i2c-scl-hz: I2C CLK frequency
- i3c-scl-hz: I3C CLK frequency

Example:

	i3c-master@28045000 {
		compatible = "phytium,cdns-i3c-master";
		reg = <0x0 0x28045000 0x0 0x1000>;
		interrupts = <GIC_SPI 168 IRQ_TYPE_LEVEL_HIGH>;
		clocks = <&coreclock>, <&i3csysclock>;
		clock-names = "pclk", "sysclk";
		#address-cells = <1>;
		#size-cells = <0>;
		i2c-scl-hz = <400000>;
		i3c-scl-hz = <1000000>;

		nunchuk: nunchuk@52 {
			compatible = "nintendo,nunchuk";
			reg = <0x52 0x0 0x10>;
		};
	};
```

## Documentation/devicetree/bindings/iio/adc/phytium,adc.yaml
```yaml
# SPDX-License-Identifier: (GPL-2.0 OR BSD-2-Clause)
# Copyright 2019 Analog Devices Inc.
%YAML 1.2
---
$id: http://devicetree.org/schemas/iio/adc/phytium,adi.yaml#
$schema: http://devicetree.org/meta-schemas/core.yaml#

title: Phytium ADC

maintainers:
  - Chen Baozi <chenbaozi@phytium.com.cn>

description: |
  This device is a 10-bit converter for 8 voltage channels. All inputs are
  single ended.

properties:
  compatible:
    const: phytium,adc

  reg:
    maxItems: 1

  clocks:
    maxItems: 1
    description: Input clock used to derive the sample clock.

  interrupts:
    maxItems: 1

  '#address-cells':
    const: 1

  '#size-cells':
    const: 0


required:
  - compatible
  - reg
  - clocks
  - interrupts
  - '#address-cells'
  - '#size-cells'

examples:
  - |
    adc0: adc@2807b000 {
      compatible = "phytium,adc";
      reg = <0x0 0x2807b000 0x0 0x1000>;
      interrupts = <GIC_SPI 232 IRQ_TYPE_LEVEL_HIGH>;
      clocks = <&sysclk_48mhz>;

      #address-cells = <1>;
      #size-cells = <0>;

      channel@0 {
        reg = <0>;
      };
      channel@1 {
        reg = <1>;
      };
      channel@2 {
        reg = <2>;
      };
      channel@3 {
        reg = <3>;
      };
      channel@4 {
       reg = <4>;
      };
      channel@5 {
        reg = <5>;
      };
      channel@6 {
        reg = <5>;
      };
      channel@7 {
        reg = <7>;
      };
    };
```

## Documentation/devicetree/bindings/interrupt-controller/phytium,d2000-ixic.txt
```
Phytium INTx interrupt controller (IXIC)

This is a psuedo interrupt controller to handle PCI legacy interrupt on
Phytium D2000 and FT-2000/4C SoC, which sits between the PCI INTx devices
and the GIC and forwards the 4 INTx input signals to 4 adjacent GICv3 SPIs.

Required properties:

- compatible		: "phytium,d2000-ixic"
			  "phytium,ft2004c-ixic"
- reg			: Specifies two regions of the register set, which
			  are called 'ctr' and 'hpb'.
- interrupt-controller	: Identifies the node as an interrupt controller.
- #interrupt-cells	: Specifies the number of cells needed to encode an
			  interrupt source. The value must be 3.
- intx-spi-base		: The SPI number of the first SPI of the 4 adjacent
			  ones the IXIC forwards its interrupts to.

Example:
	ixic: interrupt-controller@29000000 {
		compatible = "phytium,d2000-ixic";
		reg-names = "ctr", "hpb";
		reg = <0x0 0x29000000 0x0 0x00060000>,
		      <0x0 0x29100000 0x0 0x00002000>;
		interrupt-controller;
		interrupt-parent = <&gic>;
		#interrupt-cells = <3>;
		intx-spi-base = <28>;
	};
```

## Documentation/devicetree/bindings/ipmi/phytium,bt-bmc.yaml
```yaml
# SPDX-License-Identifier: (GPL-2.0-only OR BSD-2-Clause)
%YAML 1.2
---
$id: http://devicetree.org/schemas/ipmi/phytium,bt-bmc.yaml#
$schema: http://devicetree.org/meta-schemas/core.yaml#

title: Phytium BT (Block Transfer) IPMI interface

maintainers:
  - Chen Baozi <chenbaozi@phytium.com.cn>

description: |
  The Phytium E-series SOCs can be used in BMC which may have a BT
  interface used to perform in-band IPMI communication with their host.

properties:
  compatible:
    const: phytium,bt-bmc

  interrupts:
    maxItems: 1

  reg:
    maxItems: 1

required:
  - compatible
  - interrupts
  - reg

additionalProperties: false

examples:
  - |
    bt: bt@250 {
      compatible = "phytium,bt-bmc";
      reg = <0x250 0x1c>;
      interrupts = <GIC_SPI 88 IRQ_TYPE_LEVEL_HIGH>;
    };
```

## Documentation/devicetree/bindings/ipmi/phytium,kcs-bmc.yaml
```yaml
# SPDX-License-Identifier: (GPL-2.0-only OR BSD-2-Clause)
%YAML 1.2
---
$id: http://devicetree.org/schemas/ipmi/phytium,kcs-bmc.yaml#
$schema: http://devicetree.org/meta-schemas/core.yaml#

title: Phytium KCS (Keyboard Controller Style) IPMI interface

maintainers:
  - Chen Baozi <chenbaozi@phytium.com.cn>

description: |
  The Phytium E-series SOC can be used in BMC which have the KCS interface to
  perform in-band IPMI communication with their host.

properties:
  compatible:
    const: phytium,kcs-bmc

  interrupts:
    maxItems: 1

  reg:
    # maxItems: 3
    items:
      - description: IDR register
      - description: ODR register
      - description: STR register

  kcs_chan:
    deprecated: true
    $ref: '/schemas/types.yaml#/definitions/uint32'
    description: The LPC channel number in the controller

  kcs_addr:
    deprecated: true
    $ref: '/schemas/types.yaml#/definitions/uint32'
    description: The host CPU IO map address

required:
  - compatible
  - reg
  - interrupts
  - kcs_chan
  - kcs_addr

additionalProperties: false

examples:
  - |
    kcs0: kcs@24 {
      compatible = "phytium,kcs-bmc";
      reg = <0x24 0x1>, <0x30 0x1>, <0x3c 0x1>;
      interrupts = <GIC_SPI 88 IRQ_TYPE_LEVEL_HIGH>;
      kcs_chan = <1>;
      kcs_addr = <0xca0>;
    };
```

## Documentation/devicetree/bindings/leds/phytnet_led.yaml
```yaml
# SPDX-License-Identifier: (GPL-2.0-only OR BSD-2-Clause)
%YAML 1.2
---
$id: http://devicetree.org/schemas/net/phytnet_led.yaml#
$schema: http://devicetree.org/meta-schemas/core.yaml#

title: Phytium mac led controller

maintainers:
  - LongShixiang <longshixiang1718@phytium.com.cn>

description:
  This modules is used to control mac led.

properties:
  compatible:
    const: phytium,net_led
  net_dev:
    maxItems: 1
    description: Phandler of specified Net device
  led-gpios:
    minItems: 1
    maxItems: 2
    description: |-
      the gpios used for led control based on net_dev condition.
      One represents LINK condition, another represents ACT condition.

required:
  - compatible
  - net_dev
  - led-gpios

examples:
  - |
    gpiochip0: gpop_controller{
            ...
    }
    eth0: ethernet{
            ...
    }
    phytium_net_led0 {
      compatible = "phytium,net_led";
      net_dev = <&eth1>;
      led-gpios = <&gpiochip0 9 GPIO_ACTIVE_HIGH>,  /* link */
                  <&gpiochip0 11 GPIO_ACTIVE_HIGH>; /* act */
    };
```

## Documentation/devicetree/bindings/mailbox/phytium-mailbox.txt
```
Phytium Mailbox Driver
======================

The Phytium mailbox controller that has a channel/link to communicate
with the remote end. A link raises interrupt for any received data. However,
there is no specified way of knowing if the sent data has been read by the
remote. This driver assumes the sender polls STAT register and the remote
clears it after having read the data.

Mailbox Device Node:
====================

Required properties:
--------------------
- compatible:		Shall be "phytium,mbox"
- reg:			Contains the mailbox register address range (base
			address and length)
- #mbox-cells		Shall be 1 - the index of the channel needed.
- interrupts:		Contains the interrupt information corresponding to
			the link.

Example:
--------

mbox: mailbox@2a000000 {
	compatible = "phytium,mbox";
	reg = <0x0 0x2a000000 0x0 0x1000>;
	#mbox-cells = <1>;
	interrupts = <0 48 4>;
	clocks = <&sycclk>;
	clock-names = "apb_pclk";
};
```
