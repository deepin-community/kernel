## Documentation/devicetree/bindings/media/phytium,jpeg.yaml
```yaml
# SPDX-License-Identifier: (GPL-2.0 OR BSD-2-Clause)
%YAML 1.2
---
$id: http://devicetree.org/schemas/media/phytium,jpeg.yaml#
$schema: http://devicetree.org/meta-schemas/core.yaml#

title: Phytium JPEG Engine

maintainers:
  - Chen Baozi <chenbaozi@phytium.com.cn>

description: |-
  The JPEG Engine embedded in the Phytium SOCs can capture
  and compress video data from digital or analog sources.

properties:
  compatible:
    const: phytium,jpeg

  reg:
    maxItems: 1
    description: |
      Contains the offset and length of the JPEG Engine memory region.

  interrupts:
    maxItems: 1
    description: |
      The interrupt associated with the VE on this platform.

  phytium,ocm-buf-addr:
    $ref: /schemas/types.yaml#/definitions/uint64
    description: |
      The physical address used to storage the inputing video data.


required:
  - compatible
  - reg
  - interrupts
  - phytium,ocm-buf-addr

additionalProperties: false

examples:
  - |
    jpeg: jpeg@32b32000 {
      compatible = "phytium,jpeg";
      reg = <0x0 0x32b32000 0 0x1000>;
      interrupts = <0 41 4>;
      phytium,ocm-buf-addr = <0x30c40000 0x30c60000>;
      status = "okay";
    };
```

## Documentation/devicetree/bindings/misc/phytium,lpc-snoop.yaml
```yaml
# SPDX-License-Identifier: (GPL-2.0-only OR BSD-2-Clause)
%YAML 1.2
---
$id: http://devicetree.org/schemas/misc/phytium,lpc-snoop.yaml#
$schema: http://devicetree.org/meta-schemas/core.yaml#

title: Phytium lpc-snoop

maintainers:
  - Lan Hengyu <lanhengyu1395@phytium.com.cn>

description:
        The LPC snoop interface allows the BMC to listen on and record the data
        bytes written by the Host to the targeted LPC I/O pots.

properties:
  compatible:
    items:
      - enum:
          - phytium,lpc-snoop
  reg:
    maxItems: 1

  interrupts:
    maxItems: 1

  snoop-ports:
    $ref: /schemas/types.yaml#/definitions/uint32-array
    description: The LPC I/O ports to snoop

required:
  - compatible
  - interrupts
  - snoop-ports

examples:
  - |
          lpc: lpc@28010000 {
                  compatible = "simple-mfd", "syscon";
                  reg = <0x0 0x28010000 0x1000>;
                  reg-io-width = <4>;

                  #address-cells = <1>;
                  #size-cells = <1>;
                  ranges = <0x0 0x0 0x28010000 0x1000>;

                lpc_snoop: lpc-snoop@90 {
                    compatible = "phytium,lpc-snoop";
                    reg = <0x90 0x8>;
                    interrupts = <GIC_SPI 144 IRQ_TYPE_LEVEL_HIGH>;
                    snoop-ports = <0x80>;
                };
          };
```

## Documentation/devicetree/bindings/mmc/phytium,mci.yaml
```yaml
# SPDX-License-Identifier: (GPL-2.0-only OR BSD-2-Clause)
%YAML 1.2
---
$id: http://devicetree.org/schemas/mmc/phytium,mci.yaml#
$schema: http://devicetree.org/meta-schemas/core.yaml#

title: Phytium Multimedia Card Interface controller

description: |
  The highspeed MMC host controller on Phytium SoCs provides an interface
  for MMC, SD and SDIO types of memory cards.

maintainers:
  - Chen Baozi <chenbaozi@phytium.com.cn>

allOf:
  - $ref: "mmc-controller.yaml"

properties:
  compatible:
    const: phytium,mci

  reg:
    maxItems: 1
    description: mmc controller base registers.

  interrupts:
    maxItems: 1
    description: mmc controller interrupt.

  clocks:
    maxItems: 1
    description: phandles to input clocks.

  clock-names:
    items:
      - const: phytium_mci_clk

required:
  - compatible
  - reg
  - interrupts
  - clocks
  - clock-names

examples:
  - |
    mmc0: mmc@28000000 {
      compatible = "phytium,mci";
      reg = <0x0 0x28000000 0x0 0x1000>;
      interrupts = <GIC_SPI 72 IRQ_TYPE_LEVEL_HIGH>;
      clocks = <&sysclk_1200mhz>;
      clock-names = "phytium_mci_clk";
      status = "disabled";
    };

    &mmc0 {
      bus-width = <4>;
      max-frequency = <50000000>;
      cap-sdio-irq;
      cap-sd-highspeed;
      sd-uhs-sdr12;
      sd-uhs-sdr25;
      sd-uhs-sdr50;
      no-mmc;
      status = "ok";
    };
```

## Documentation/devicetree/bindings/mtd/phytium,nfc.yaml
```yaml
# SPDX-License-Identifier: (GPL-2.0-only OR BSD-2-Clause)
%YAML 1.2
---
$id: http://devicetree.org/schemas/mtd/phytium,nfc.yaml#
$schema: http://devicetree.org/meta-schemas/core.yaml#

title: Phytium Nand Flash controller

maintainers:
  - Chen Baozi <chenbaozi@phytium.com.cn>

properties:
  compatible:
    const: phytium,nfc

  reg:
    maxItems: 1

  interrupts:
    maxItems: 1

  nand-ecc-strength:
    const: 8

  nand-ecc-step-size:
    const: 512

allOf:
  - $ref: "nand-controller.yaml#"

required:
  - compatible
  - reg
  - interrupts

examples:
  - |
    nand0: nand@28002000 {
      compatible = "phytium,nfc";
      reg = <0x0 0x28002000 0x0 0x1000>;
      interrupts = <GIC_SPI 74 IRQ_TYPE_LEVEL_HIGH>;
    };
```

## Documentation/devicetree/bindings/net/can/phytium,can.yaml
```yaml
# SPDX-License-Identifier: (GPL-2.0-only OR BSD-2-Clause)
%YAML 1.2
---
$id: http://devicetree.org/schemas/net/can/phytium,can.yaml#
$schema: http://devicetree.org/meta-schemas/core.yaml#

title:
  Phytium CAN controller

maintainers:
  - Chen Baozi <chenbaozi@phytium.com.cn>

properties:
  compatible:
    enum:
      - phytium,can
      - phytium,canfd

  reg:
    maxItems: 1
    description: Should contain the controller registers location and length

  interrupts:
    maxItems: 1
    description: Should contain IRQ line for the controller

  clocks:
    maxItems: 1
    description: Input clock used by the controller

  clock-names:
    maxItems: 1
    description: Input clock name, should be "can_clk"
    const: can_clk

  tx-fifo-depth:
    $ref: "/schemas/types.yaml#/definitions/uint32"
    description: Indicates the length of TX FIFO

  rx-fifo-depth:
    $ref: "/schemas/types.yaml#/definitions/uint32"
    description: Indicates the length of RX FIFO

  extend_brp:
    description: |
      Indicates to apply the extend BRP parameter of bit timming for
      early version of CAN controller

required:
  - compatible
  - reg
  - interrupts
  - clocks
  - clock-names
  - tx-fifo-depth
  - rx-fifo-depth

allOf:
  - $ref: can-controller.yaml#

examples:
  - |

    can0: can@2800a000 {
      compatible = "phytium,canfd";
      reg = <0x0 0x2800a000 0x0 0x1000>;
      interrupts = <GIC_SPI 81 IRQ_TYPE_LEVEL_HIGH>;
      clocks = <&sysclk_600mhz>;
      clock-names = "can_clk";
      tx-fifo-depth = <64>;
      rx-fifo-depth = <64>;
    };
```

## Documentation/devicetree/bindings/net/ultrarisc,dp1000-gmac.yaml
```yaml
# SPDX-License-Identifier: (GPL-2.0-only OR BSD-2-Clause)
%YAML 1.2
---
$id: http://devicetree.org/schemas/net/ultrarisc,dp1000-gmac.yaml#
$schema: http://devicetree.org/meta-schemas/core.yaml#

title: Ultrarisc dp1000 glue layer

maintainers:
  - Han Gao <gaohan@iscas.ac.cn>

select:
  properties:
    compatible:
      contains:
        enum:
          - ultrarisc,dp1000-gmac
  required:
    - compatible

properties:
  compatible:
    oneOf:
      - items:
          - const: ultrarisc,dp1000-gmac
          - const: snps,dwmac-5.10a

  reg:
    maxItems: 1

  clocks:
    items:
      - description: GMAC main clock
      - description: PTP clock
      - description: TX clock

  clock-names:
    items:
      - const: stmmaceth

  dma-noncoherent: true

  interrupts:
    maxItems: 1

  interrupt-names:
    maxItems: 1

required:
  - compatible
  - reg
  - clocks
  - clock-names
  - interrupts
  - interrupt-names

allOf:
  - $ref: snps,dwmac.yaml#

unevaluatedProperties: false

examples:
  - |
    #include <dt-bindings/interrupt-controller/irq.h>

    ethernet1@38000000 {
      clocks = <&csr_clk>;
      clock-names = "stmmaceth";
      compatible = "ultrarisc,dp1000-gmac", "snps,dwmac-5.10a";
      interrupt-parent = <0x01>;
      interrupts = <84>;
      interrupt-names = "macirq";
      reg = <0x00 0x38000000 0x00 0x1000000>;
      local-mac-address = [ff ff ff ff ff ff];
      phy-mode = "rgmii";
      max-speed = <1000>;
      snps,txpbl = <8>;
      snps,rxpbl = <8>;
      phy-handle = <&phy0>;
      mdio {
        #address-cells = <0x01>;
        #size-cells = <0x00>;
        compatible = "snps,dwmac-mdio";
        phy0: phy@0{
          reg = <0x00>;
          status = "okay";
        };
      };
    };
```

## Documentation/devicetree/bindings/nvmem/sophgo,efuse.yaml
```yaml
# SPDX-License-Identifier: GPL-2.0-only OR BSD-2-Clause
%YAML 1.2
---
$id: http://devicetree.org/schemas/nvmem/sophgo,efuse.yaml#
$schema: http://devicetree.org/meta-schemas/core.yaml#

title: Sophgo SoC eFuse-based NVMEM

description:
  Sophgo SoCs contain factory-programmed eFuses used to store ROM patch,
  public key and other factory information.

maintainers:
  - Inochi Amaoto <inochiama@gmail.com>

allOf:
  - $ref: nvmem.yaml#

properties:
  compatible:
    enum:
      - sophgo,sg2044-efuse

  reg:
    maxItems: 1

  clocks:
    minItems: 1
    items:
      - description: Core clock
      - description: APB clock

  clock-names:
    minItems: 1
    items:
      - const: core
      - const: apb

  resets:
    maxItems: 1

required:
  - compatible
  - reg
  - clocks

unevaluatedProperties: false

examples:
  - |
    efuse@40000000 {
        compatible = "sophgo,sg2044-efuse";
        reg = <0x40000000 0x1000>;
        #address-cells = <1>;
        #size-cells = <1>;
        clocks = <&clk 0>,
                 <&clk 1>;
        clock-names = "core", "apb";
    };

...
```

## Documentation/devicetree/bindings/pci/phytium,pd2008-pcie-ep.yaml
```yaml
# SPDX-License-Identifier: (GPL-2.0-only OR BSD-2-Clause)
%YAML 1.2
---
$id: http://devicetree.org/schemas/pci/phytium,pd2008-pcie-ep.yaml#
$schema: http://devicetree.org/meta-schemas/core.yaml#

title: Phytium PCIe endpoint controller

maintainers:
  - Chen Baozi <chenbaozi@phytium.com.cn>

allOf:
  - $ref: "pci-ep.yaml#"

properties:
  compatible:
    const: phytium,pd2008-pcie-ep

  reg:
    maxItems: 2

  reg-names:
    items:
      - const: reg
      - const: mem

required:
  - compatible
  - reg
  - reg-names

examples:
  - |
    ep0: ep@0x29030000 {
      compatible = "phytium,pd2008-pcie-ep";
      reg = <0x0 0x29030000 0x0 0x10000>,
            <0x11 0x00000000 0x1 0x00000000>,
            <0x0 0x29101000 0x0 0x1000>;
      reg-names = "reg", "mem", "hpb";
      max-outbound-regions = <3>;
      max-functions = /bits/ 8 <1>;
    };
```

## Documentation/devicetree/bindings/pci/phytium,phytium-pcie-ep.txt
```
* Phytium PCIe endpoint controller

Required properties:
- compatible: Should contain "phytium,phytium-pcie-ep" to identify the IP used.
- reg: Should contain the controller register base address, AXI interface
  region base address and hpb register base address respectively.
- reg-names: Must be "reg", "mem" and "hpb" respectively.
- max-outbound-regions: Set to maximum number of outbound regions.
- max-functions: Maximum number of functions that can be configured (default 1).

Example:

ep0: ep@0x29030000 {
	compatible = "phytium,d2000-pcie-ep";
	reg = <0x0 0x29030000 0x0 0x10000>,
	      <0x11 0x00000000 0x1 0x00000000>,
	      <0x0 0x29101000 0x0 0x1000>;
	reg-names = "reg", "mem", "hpb";
	max-outbound-regions = <3>;
	max-functions = /bits/ 8 <1>;
};
```

## Documentation/devicetree/bindings/pinctrl/ultrarisc,dp1000-pinctrl.yaml
```yaml
# SPDX-License-Identifier: (GPL-2.0-only OR BSD-2-Clause)
%YAML 1.2
---
$id: http://devicetree.org/schemas/pinctrl/ultrarisc,dp1000-pinctrl.yaml#
$schema: http://devicetree.org/meta-schemas/core.yaml#

title: UltraRISC DP1000 Pin Controller
maintainers:
  - Jia Wang <wangjia@ultrarisc.com>

description: |
  UltraRISC RISC-V SoC DP1000 pin controller.
  <dt-bindings/pinctrl/ur-dp1000-pinctrl.h> contains the pinmux definitions.

properties:
  compatible:
    const: ultrarisc,dp1000-pinctrl

  reg:
    maxItems: 1

  pinctrl-single,register-width:
    description:
      The width of the register used to configure the pinmux.
    $ref: /schemas/types.yaml#/definitions/uint32
    enum: [32]

  pinctrl-single,function-mask:
    description:
      The mask of the functions that can be selected for the pinmux.
    $ref: /schemas/types.yaml#/definitions/uint32
    enum: [0x3ff]

  pinctrl-use-default:
    description:
      If this property is set, the pinmux will be set to the default value.
    type: boolean

patternProperties:
  '^[a-zA-Z0-9_]+$':
    type: object
    additionalProperties: false
    patternProperties:
      '-pins$':
        type: object
        description: |
          A pinctrl node should contain at least one subnode representing the
          pinctrl groups available on the machine. Each subnode will list the
          pins it needs, and how they should be configured, with regard to
          muxer configuration, bias etc.
        properties:
          pinctrl-pins:
            description:
              The list of Pins and their mux settings that properties in the
              node apply to. The format: `PORT  PIN  FUNCTION`.
            minItems: 1
            maxItems: 32
            items:
              $ref: /schemas/types.yaml#/definitions/uint32
          pinconf-pins:
            description:
              The list of Pins and their bias settings that properties in the
              node apply to. The format: `PORT  PIN  BIAS`.The BIAS should be
              set using the UR_DP1000_BIAS macros.
            minItems: 1
            maxItems: 32
            items:
              $ref: /schemas/types.yaml#/definitions/uint32

examples:
  - |
    pmx0: pinmux@40000000 {
      compatible = "ultrarisc,dp1000-pinctrl";
      reg = <0x0 0x11081000  0x0 0x1000>;
      #address-cells = <1>;
      #size-cells = <0>;
      #pinctrl-cells = <2>;
      pinctrl-single,register-width = <32>;
      pinctrl-single,function-mask = <0x3ff>;
      pinctrl-use-default;

      i2c0_pins: i2c0_pins {
        pinctrl-pins = <
          UR_DP1000_IOMUX_A  12  UR_FUNC0
          UR_DP1000_IOMUX_A  13  UR_FUNC0
          >;

        pinconf-pins = <
          UR_DP1000_IOMUX_A  12  UR_DP1000_BIAS(UR_PULL_UP, UR_DRIVE_DEF)
          UR_DP1000_IOMUX_A  13  UR_DP1000_BIAS(UR_PULL_UP, UR_DRIVE_DEF)
          >;
      };

      i2c1_pins: i2c1_pins {
        pinctrl-pins = <
          UR_DP1000_IOMUX_B  6  UR_FUNC0
          UR_DP1000_IOMUX_B  7  UR_FUNC0
          >;

        pinconf-pins = <
          UR_DP1000_IOMUX_B  6  UR_DP1000_BIAS(UR_PULL_UP, UR_DRIVE_DEF)
          UR_DP1000_IOMUX_B  7  UR_DP1000_BIAS(UR_PULL_UP, UR_DRIVE_DEF)
          >;
      };
    };
```
