## Documentation/devicetree/bindings/pci/ultrarisc,dp1000-pcie.yaml
```yaml
# SPDX-License-Identifier: (GPL-2.0 OR BSD-2-Clause)
%YAML 1.2
---
$id: http://devicetree.org/schemas/pci/ultrarisc,dp1000-pcie.yaml#
$schema: http://devicetree.org/meta-schemas/core.yaml#

title: UltraRISC DP1000 PCIe Host Controller

description: |
  UltraRISC DP1000 SoC PCIe host controller is based on the DesignWare PCIe IP.
  This binding describes the UltraRISC specific extensions to the base DesignWare
  PCIe binding.

maintainers:
  - Xincheng Zhang <zhangxincheng@ultrarisc.com>
  - Jia Wang <wangjia@ultrarisc.com>

allOf:
  - $ref: /schemas/pci/pci-bus.yaml#

properties:
  compatible:
    const: ultrarisc,dp1000-pcie

  reg:
      - description: Data Bus Interface (DBI) registers.
      - description: PCIe configuration space region.

  reg-names:
    items:
      - const: dbi
      - const: config

  num-lanes:
    $ref: /schemas/types.yaml#/definitions/uint32
    description:
      Number of lanes to use.
      Valid values: 4, 16.

  max-link-speed:
    $ref: /schemas/types.yaml#/definitions/uint32
    const: 4
    description:
      Maximum PCIe link speed supported. 4 for Gen4.

  interrupt-names:
    items:
      - const: msi
      - const: inta
      - const: intb
      - const: intc
      - const: intd

  device_type:
    const: pci

  dma-coherent:
    type: boolean

  bus-range:
    description:
      PCI bus range associated with this controller.

  interrupt-map-mask:
    description:
      PCI interrupt map mask for this controller.

  interrupt-map:
    description:
      PCI interrupt map for this controller.

  required:
  - compatible
  - reg
  - reg-names
  - interrupts
  - interrupt-names
  - device_type

unevaluatedProperties: false

examples:
  - |
    pcie_x16: pcie@21000000 {
        compatible = "ultrarisc,dp1000-pcie";
        #address-cells = <3>;
        #size-cells = <2>;
        #interrupt-cells = <1>;
        reg = <0x0 0x21000000 0x0 0x01000000>, /* IP registers */
              <0x0 0x4fff0000 0x0 0x00010000>; /* Configuration space */
        reg-names = "dbi", "config";
        device_type = "pci";
        dma-coherent;
        bus-range = <0x0 0xff>;
        num-lanes = <16>;
        ranges = <0x81000000  0x0 0x4fbf0000  0x0 0x4fbf0000  0x0 0x00400000>, /* io */
                 <0x82000000  0x0 0x40000000  0x0 0x40000000  0x0 0x0fbf0000>, /* mem32 */
                 <0xc3000000 0x40 0x00000000 0x40 0x00000000  0xd 0x00000000>; /* mem64 prefetchable */
        max-link-speed = <4>;
        interrupt-parent = <&plic>;
        interrupts = <43>, <44>, <45>, <46>, <47>;
        interrupt-names = "msi", "inta", "intb", "intc", "intd";
        interrupt-map-mask = <0x0 0x0 0x0 0x7>;
        interrupt-map = <0x0 0x0 0x0 0x1 &plic 44>,
                        <0x0 0x0 0x0 0x2 &plic 45>,
                        <0x0 0x0 0x0 0x3 &plic 46>,
                        <0x0 0x0 0x0 0x4 &plic 47>;
    };
```

## Documentation/devicetree/bindings/security/loongson_se/se.yaml
```yaml
# SPDX-License-Identifier: (GPL-2.0-only OR BSD-2-Clause)
%YAML 1.2
---
$id: http://devicetree.org/schemas/security/loongson_se/se.yaml#
$schema: http://devicetree.org/meta-schemas/core.yaml#

title: Loongson SE module

description:
  Loongson SE module
maintainers:
  - Qunqin Zhao <zhaoqunqin@loongson.cn>

allOf:
  - $ref: se.yaml#

properties:
  compatible:
    const: loongson,ls3c6000se

  reg:
    maxItems: 2

  interrupts:
    maxItems: 2

required:
  - compatible
  - reg
  - interrupts

additionalProperties: false
```

## Documentation/devicetree/bindings/serial/phytium,uart-2.0.yaml
```yaml
# SPDX-License-Identifier: (GPL-2.0-only OR BSD-2-Clause)
%YAML 1.2
---
$id: http://devicetree.org/schemas/serial/phytium,uart-v2.yaml#
$schema: http://devicetree.org/meta-schemas/core.yaml#

title: Phytium serial UART v2

maintainers:
  - Hengyu Lan <lanhengyu1395@phytium.com.cn>

allOf:
  - $ref: serial.yaml#

# Need a custom select here or 'arm,primecell' will match on lots of nodes
select:
  properties:
    compatible:
      contains:
        enum:
          - phytium,uart-2.0
  required:
    - compatible

properties:
  compatible:
    items:
      - const: phytium,uart-2.0

  reg:
    maxItems: 2

  interrupts:
    maxItems: 1

  clocks:
    description:
      When present, the first clock listed must correspond to
      the clock named UARTCLK on the IP block, i.e. the clock
      to the external serial line, whereas the second clock
      must correspond to the PCLK clocking the internal logic
      of the block. Just listing one clock (the first one) is
      deprecated.
    maxItems: 2

  clock-names:
    items:
      - const: uartclk
      - const: apb_pclk

required:
  - compatible
  - reg
  - interrupts

unevaluatedProperties: false

examples:
  - |
    uart@27011000 {
            compatible = "phytium,uart-2.0";
            reg = <0x0 0x27011000 0x0 0x1000>,
            <0x0 0x26fe4000 0x0 0x1000>;
            interrupts = <GIC_SPI 66 IRQ_TYPE_LEVEL_HIGH>;
            clocks = <&sysclk_100mhz &sysclk_100mhz>;
            clock-names = "uartclk", "apb_pclk";
            status = "disabled";
    };
...
```

## Documentation/devicetree/bindings/sound/phytium,codec-2.0.yaml
```yaml
# SPDX-License-Identifier: (GPL-2.0 OR BSD-2-Clause)
%YAML 1.2
---
$id: http://devicetree.org/schemas/sound/phytium,codec-2.0.yaml#
$schema: http://devicetree.org/meta-schemas/core.yaml#

title: Phytium Codec V2 Controller

maintainers:
  - Dai Jingtao <daijingtao1503@phytium.com.cn>
  - Zhou Zheng <zhouzheng2069@phytium.com.cn>

properties:
  compatible:
    enum:
      - phytium,codec-2.0

  reg:
    items:
      - first is for physical base address and length of regfile.
      - second is for sharemem to send command.

  interrupts:
    maxItems: 1

required:
  - compatible
  - reg
  - interrupts

examples:
  - |
    codec_v2: codec@27010800 {
      compatible = "phytium,codec-2.0";
      #sound-dai-cells = <0x0>;
      reg = <0x0 0x27010800 0x0 0x800>,
            < 0x0 0x26fe3100 0x0 0x100>;
      interrupts = <GIC_SPI 83 IRQ_TYPE_LEVEL_HIGH>;
      status = "disabled";
    };
```

## Documentation/devicetree/bindings/sound/phytium,hda.yaml
```yaml
# SPDX-License-Identifier: (GPL-2.0 OR BSD-2-Clause)
%YAML 1.2
---
$id: http://devicetree.org/schemas/sound/phytium,hda.yaml#
$schema: http://devicetree.org/meta-schemas/core.yaml#

title: Phytium HD Audio controller

maintainers:
  - Chen Baozi <chenbaozi@phytium.com.cn>

properties:
  compatible:
    const: phytium,hda

  reg:
    minItems: 1
    description: address and length of the HDA controller registers

  interrupts:
    maxItems: 1
    description: HDA controller interrupt

  clocks:
    maxItems: 1
    description: clock phandle for the HDA controller

required:
  - compatible
  - reg
  - interrupts
  - clocks

unevaluatedProperties: false

examples:
  - |
    #include <dt-bindings/interrupt-controller/arm-gic.h>

    hda: hda@2800d000 {
      compatible = "phytium,hda";
      reg = <0x0 0x2800d000 0x0 0x1000>;
      interrupts = <GIC_SPI 19 IRQ_TYPE_LEVEL_HIGH>;
      clocks = <&sysclk_48mhz>;
    };
```

## Documentation/devicetree/bindings/sound/phytium,i2s-2.0.yaml
```yaml
# SPDX-License-Identifier: (GPL-2.0 OR BSD-2-Clause)
%YAML 1.2
---
$id: http://devicetree.org/schemas/sound/phytium,virt-i2s.yaml#
$schema: http://devicetree.org/meta-schemas/core.yaml#

title: Phytium I2S V2 Controller

maintainers:
  - Dai Jingtao <daijingtao1503@phytium.com.cn>

properties:
  compatible:
    enum:
      - phytium,i2s-2.0

  reg:
    items:
      - first is for physical base address and length of I2S regfile.
      - second is for sharemem to send command.
      - third is for physical base address and length of DMA_BDL controller.

  interrupts:
    maxItems: 2

  clocks:
    items:
      - description: Bus Clock

  clock-names:
    items:
      - const: i2s_clk

required:
  - compatible
  - reg
  - interrupts
  - clocks
  - clock-names


examples:
  - |
    i2s_v2: i2s@27010000 {
      compatible = "phytium,i2s-2.0";
      reg = <0x0 0x27010000 0x0 0x800>,
            <0x0 0x26fe3000 0x0 0x100>,
            <0x0 0x18000000 0x0 0x1000>;
      interrupts = <GIC_SPI 110 IRQ_TYPE_LEVEL_HIGH>,
                   <GIC_SPI 83 IRQ_TYPE_LEVEL_HIGH>;
      clocks = <&sysclk_1200mhz>;
      clock-names = "i2s_clk";
    };
```

## Documentation/devicetree/bindings/spi/phytium,spi.yaml
```yaml
# SPDX-License-Identifier: (GPL-2.0 OR BSD-2-Clause)
%YAML 1.2
---
$id: http://devicetree.org/schemas/spi/phytium,spi.yaml#
$schema: http://devicetree.org/meta-schemas/core.yaml#

title: Phytium SPI controller

maintainers:
  - Chen Baozi <chenbaozi@phytium.com.cn>

allOf:
  - $ref: spi-controller.yaml#

properties:
  compatible:
    const: phytium,spi

  reg:
    minItems: 1
    description: address and length of the spi master registers

  interrupts:
    maxItems: 1
    description: should contain one interrupt

  clocks:
    maxItems: 1
    description: spi clock phandle

  num-cs:
    $ref: /schemas/types.yaml#/definitions/uint32
    description: number of chip selects used
    default: 4

  reg-io-width:
    $ref: /schemas/types.yaml#/definitions/uint32
    enum: [ 4 ]
    description: I/O register width in bytes
    default: 4

  global-cs:
    $ref: /schemas/types.yaml#/definitions/uint32
    enum: [ 0, 1 ]
    description: |
      When set to 1, the controller drives all chip selects through a
      single global chip-select line (GCSR mode).
    default: 1

  dmas:
    minItems: 2
    maxItems: 2
    description: TX and RX DMA channel specifiers

  dma-names:
    items:
      - const: rx
      - const: tx

required:
  - compatible
  - "#address-cells"
  - "#size-cells"
  - reg
  - interrupts
  - clocks
  - num-cs

unevaluatedProperties: false

examples:
  - |
    #include <dt-bindings/interrupt-controller/arm-gic.h>

    spi0: spi@2800c000 {
      compatible = "phytium,spi";
      #address-cells = <1>;
      #size-cells = <0>;
      interrupts = <GIC_SPI 18 IRQ_TYPE_LEVEL_HIGH>;
      reg = <0x0 0x2800c000 0x0 0x1000>;
      clocks = <&sysclk_48mhz>;
      num-cs = <4>;
    };
```

## Documentation/devicetree/bindings/staging/phytium-npu.yaml
```yaml
# SPDX-License-Identifier: (GPL-2.0-only OR BSD-2-Clause)
%YAML 1.2
---
$id: http://devicetree.org/schemas/staging/phytium-npu.yaml#
$schema: http://devicetree.org/meta-schemas/core.yaml#
title: Phytium NPU controller
maintainers:
  - Cheng Quan <chengquan@phytium.com.cn>
properties:
  compatible:
    const: phytium,npu

  reg:
    items: 2
      - description: NPU registers and PM registers

  interrupts:
    maxItems: 1

  dma-mask:
    maxItems: 1
      - description: NPU dma capability

required:
  - compatible
  - reg
  - interrupts

examples:
  - |
    npu@26d00000 {
        compatible = "phytium,npu";
		reg = <0x0 0x26d00000 0x0 0x80000
               0x0 0x26fcc060 0x0 0x20>;
        interrupts = <0 74 4>;
        dma-mask=<0xff 0xffffffff>;
    };
```

## Documentation/devicetree/bindings/usb/phytium,usb2-2.0.yaml
```yaml
# SPDX-License-Identifier: GPL-2.0-only OR BSD-2-Clause
%YAML 1.2
---
$id: http://devicetree.org/schemas/usb/phytium,usb2-2.0.yaml#
$schema: http://devicetree.org/meta-schemas/core.yaml#

title: Phytium USBHS-DRD controller bindings

maintainers:
  - Chen Zhenhua <chenzhenhua@phytium.com>

properties:
  compatible:
    const: phytium,usb2-2.0

  reg:
    items:
      - description: USB controller registers

  interrupts:
    maxItems: 1

required:
  - compatible
  - reg
  - interrupts

additionalProperties: false

examples:
  - |
    usb2_0: usb2@26f00000 {
            compatible = "phytium,usb2-2.0";
            reg = <0x0 0x26f00000 0x0 0x4000>,
                <0x0 0x26f04000 0x0 0x4000>,
                <0x0 0x26f08000 0x0 0x18000>;
            interrupts = <GIC_SPI 20 IRQ_TYPE_LEVEL_HIGH>,  //host & device interrupt
            <GIC_SPI 148 IRQ_TYPE_LEVEL_HIGH>; //otg interrupt
    };
```
