## Documentation/devicetree/bindings/dma/phytium,gdma.yaml
```yaml
# SPDX-License-Identifier: (GPL-2.0-only OR BSD-2-Clause)
%YAML 1.2
---
title: Phytium GDMA Controller bindings

description:
  The Phytium GDMA is a general-purpose direct memory access
  controller capable of supporting 16 independent DMA channels.
  DMA clients connected to the GDMA controller must use the format
  described in the dma-common.yaml file, using a one cell specifier for
  each channel, just provide the channel id to use.

maintainers:
  - Huang Jie <huangjie1663@phytium.com.cn>

allOf:
  - $ref: "dma-controller.yaml#"

properties:
  "#dma-cells":
    const: 1

  compatible:
    const: phytium,gdma

  reg:
    maxItems: 1

  interrupts:
    minItems: 1
    description: set interrupts according to the programming manual

  dma-channels:
    minimum: 1
    maximum: 16

  max-outstanding:
    minimum: 1
    maximum: 64
    description: set max-outstanding according to the programming manual

required:
  - compatible
  - reg
  - interrupts
  - dma-channels
  - max-outstanding

unevaluatedProperties: false

examples:
  - |
    gdma: gdma@32b34000 {
      compatible = "phytium,gdma";
      dma-channels = <16>;
      max-outstanding = <16>;
      reg = <0x0 0x32b34000 0x0 0x1000>;
      interrupts = <GIC_SPI 234 IRQ_TYPE_LEVEL_HIGH>;
      #dma-cells = <1>;
    };
```

## Documentation/devicetree/bindings/hwmon/ultrarisc,dp1000-pvt.yaml
```yaml
# SPDX-License-Identifier: (GPL-2.0 OR BSD-2-Clause)
%YAML 1.2
---
$id: http://devicetree.org/schemas/hwmon/ultrarisc,dp1000-pvt.yaml#
$schema: http://devicetree.org/meta-schemas/core.yaml#

title: UltraRISC DP1000 Core PVT Sensor

maintainers:
  - Jia Wang <wangjia@ultrarisc.com>

description: |
  UltraRISC DP1000 SoC provides a voltage and temperature (PVT) sensor to
  monitor the internal SoC environment including chip temperature and supply voltage.

properties:
  compatible:
    const: ultrarisc,dp1000-pvt

  reg:
    maxItems: 1
    description: Register space of the PVT controller

  interrupts:
    maxItems: 1
    description: Optional interrupt number for the PVT controller. This property is optional and can be omitted if not used.

  clock-frequency:
    description: Clock frequency of the PVT controller in Hz

  channels:
    description: Total number of PVT channels supported

patternProperties:
  "^channel@[0-9a-f]+$":
    type: object
    description: Child node describing a PVT channel
    properties:
      reg:
        description: Channel index
        minimum: 0
        maximum: 63

      label:
        description: Name for this channel, typically indicating its purpose

      trim:
        description: Trim value for calibration
        default: 7
        minimum: 0
        maximum: 15

    required:
      - reg
      - label

required:
  - compatible
  - reg
  - clock-frequency
  - channels

additionalProperties: false

examples:
  - |
    core_pvt: pvt@20008000 {
        compatible = "ultrarisc,dp1000-pvt";
        reg = <0x20008000 0x1000>;
        clock-frequency = <4000000>;
        channels = <13>;

        channel@0 {
            reg = <0>;
            label = "Core temp0";
            trim = <7>;
        };

        channel@1 {
            reg = <1>;
            label = "Core temp1";
            trim = <7>;
        };

        channel@2 {
            reg = <2>;
            label = "Core temp2";
            trim = <7>;
        };
    };
```

## Documentation/devicetree/bindings/i2c/phytium,i2c-2.0.yaml
```yaml
# SPDX-License-Identifier: (GPL-2.0 OR BSD-2-Clause)
%YAML 1.2
---

title: Phytium I2C Controller

maintainers:
  - WuJinyong <wujinyong1788@phytium.com.cn>

properties:
  compatible:
    - description: Phytium I2C controller
      const: phytium,i2c-2.0

  reg:
    minItems: 1
    items:
      - description: Offset and length of the memory mapped registers
      - description: Offset and length of the memory mapped share memory address

  interrupts:
    maxItems: 1

  clocks:
    minItems: 1
    items:
      - description: I2C controller reference clock source

  clock-frequency:
    description: Desired I2C bus clock frequency in Hz
    enum: [100000, 400000, 1000000, 3400000]
    default: 400000

  i2c-sda-hold-time-ns:
    description: |
      The property should contain the SDA hold time in nanoseconds. This option
      is only supported in hardware blocks version 1.11a or newer or on
      Microsemi SoCs.

  i2c-scl-falling-time-ns:
    description: |
      The property should contain the SCL falling time in nanoseconds.
      This value is used to compute the tLOW period.
    default: 300

  i2c-sda-falling-time-ns:
    description: |
      The property should contain the SDA falling time in nanoseconds.
      This value is used to compute the tHIGH period.
    default: 300

unevaluatedProperties: false

required:
  - compatible
  - reg
  - interrupts

examples:
  - |
    i2c@0x2701a000 {
      compatible = "phytium,i2c-2.0";
      reg = <0x0 0x2701a000 0x0 0x1000 0x0 0x2701e000 0x0 0x200>;
      interrupts = <GIC_SPI 89 IRQ_TYPE_LEVEL_HIGH>;
      clock-frequency = <400000>;
    };
  - |
    i2c@2701a000 {
      compatible = "phytium,i2c-2.0";
      reg = <0x0 0x2701a000 0x0 0x1000 0x0 0x2701e000 0x0 0x200>;
      interrupts = <GIC_SPI 89 IRQ_TYPE_LEVEL_HIGH>;
      clock-frequency = <400000>;
      i2c-sda-hold-time-ns = <300>;
      i2c-sda-falling-time-ns = <300>;
      i2c-scl-falling-time-ns = <300>;
    };
  - |
    i2c@2701a000 {
      compatible = "phytium,i2c-2.0";
      reg = <0x0 0x2701a000 0x0 0x1000 0x0 0x2701e000 0x0 0x200>;
      #address-cells = <1>;
      #size-cells = <0>;
      clock-frequency = <400000>;
      clocks = <&i2cclk>;
      interrupts = <GIC_SPI 89 IRQ_TYPE_LEVEL_HIGH>;

      eeprom@64 {
        compatible = "atmel,24c02";
        reg = <0x64>;
      };
    };
...
```

## Documentation/devicetree/bindings/media/phytium,jpeg-vram.yaml
```yaml
# SPDX-License-Identifier: (GPL-2.0-only OR BSD-2-Clause)
%YAML 1.2
---
$id: "http://devicetree.org/schemas/reserved-memory/phytium-jpeg-vram.yaml#"
$schema: "http://devicetree.org/meta-schemas/core.yaml#"

title: Phytium JPEG VRAM Engine

maintainers:
  - Wang Hao <wanghao1851@phytium.com.cn>

description: |
  The JPEG VRAM Engine embedded in the Phytium SOCs can capture
  and compress video data from digital or analog sources.

properties:
  compatible:
    const: "phytium,jpeg-vram"

  reg:
    maxItems: 1
    description: |
      Contains the offset and length of the JPEG Engine memory region.

  interrupts:
    maxItems: 1
    description: >
      The interrupt associated with the VE on this platform.

  ddr-mode:
    type: object
    description: >
      Additional properties for DDR mode configuration.

    properties:
      phytium,dc-reg:
        $ref: "/schemas/types.yaml#/definitions/uint64-array"
        description: >
          Address and size of the DC (Display Controller) register region.

      phytium,dc-vram:
        $ref: "/schemas/types.yaml#/definitions/uint64-array"
        description: >
          Address and size of the DC framebuffer region.

      phytium,jpeg-vram:
        $ref: "/schemas/types.yaml#/definitions/uint64-array"
        description: >
          Address and size of the JPEG-specific framebuffer region.

      phytium,trans-reg:
        $ref: "/schemas/types.yaml#/definitions/uint64-array"
        description: >
          Address and size of the transaction register region.

    required:
      - phytium,dc-reg
      - phytium,dc-vram
      - phytium,jpeg-vram
      - phytium,trans-reg

required:
  - compatible
  - reg
  - interrupts
  - ddr-mode

additionalProperties: false

examples:
  - |
    jpeg_vram0: jpeg_vram@32b32000 {
      compatible = "phytium,jpeg-vram";
      reg = <0x0 0x32b32000 0 0x1000>,
            <0x0 0x32000000 0 0x8000>;
      interrupts = <GIC_SPI 41 IRQ_TYPE_LEVEL_HIGH>;
      status = "disabled";
      ddr-mode {
        phytium,dc-reg = <0x32000000 0x2000>;
        phytium,dc-vram = <0xf4000000 0x4000000>;
        phytium,jpeg-vram = <0xf9000000 0x1000000>;
        phytium,trans-reg = <0x32b3a000 0x1000>;
      };
    };
```

## Documentation/devicetree/bindings/misc/phytium,snoop-ctrl.yaml
```yaml
# SPDX-License-Identifier: (GPL-2.0-only OR BSD-2-Clause)
%YAML 1.2
---
$id: http://devicetree.org/schemas/misc/phytium,snoop-ctrl.yaml#
$schema: http://devicetree.org/meta-schemas/core.yaml#

title: Phytium BMC Snoop Controller

maintainers:
  - Lan Hengyu <lanhengyu1395@phytium.com.cn>

description:
        The snoop controller allows the BMC to listen on and record the data
        bytes written by the Host to the target I/O ports.

properties:
  compatible:
    items:
      - enum:
          - phytium,snoop-ctrl
  reg:
    maxItems: 1

  interrupts:
    maxItems: 1

  snoop-ports:
    $ref: /schemas/types.yaml#/definitions/uint32-array
    description: Ports to snoop

required:
  - compatible
  - interrupts
  - snoop-ports

examples:
  - |
      snoop: snoop@28010000 {
          compatible = "phytium,snoop-ctrl", "syscon";
          reg = <0x0 0x28010000 0x0 0x1000>;
          interrupts = <GIC_SPI 144 IRQ_TYPE_LEVEL_HIGH>;
          snoop-ports = <0x80 0x81>;
      };
```

## Documentation/devicetree/bindings/mmc/phytium,mci_v2.yaml
```yaml
# SPDX-License-Identifier: (GPL-2.0-only OR BSD-2-Clause)
%YAML 1.2
---
$id: http://devicetree.org/schemas/mmc/phytium,mci_v2.yaml#
$schema: http://devicetree.org/meta-schemas/core.yaml#

title: Phytium Multimedia Card Interface controller

description: |
  The highspeed MMC host V2 controller on Phytium SoCs provides an interface
  for MMC, SD and SDIO types of memory cards.

maintainers:
  - Lai Xueyu <laixueyu1280@phytium.com.cn>

allOf:
  - $ref: "mmc-controller.yaml"

properties:
  compatible:
    const: phytium,mci_2.0

  reg:
    maxItems: 2
    description: mmc controller regfile base registers.
    description: mmc controller share memory base registers.

  interrupts:
    maxItems: 1
    description: mmc controller v2 interrupt.

  clocks:
    maxItems: 1
    description: phandles to input clocks.

  clock-names:
    items:
      - const: phytium_mci_clk

required:
  - compatible
  - reg
  - interrupts
  - clocks
  - clock-names

examples:
  - |
    mmc0_v2: mmc@27018000 {
      compatible = "phytium,mci_2.0";
      reg = <0x0 0x27018000 0x0 0x1000>,
           <0x0 0x26fea000 0x0 0x1000>;
      interrupts = <GIC_SPI 89 IRQ_TYPE_LEVEL_HIGH>;
      clocks = <&sysclk_1200mhz>;
      clock-names = "phytium_mci_clk";
      status = "disabled";
    };

    &mmc0 {
      bus-width = <4>;
      max-frequency = <50000000>;
      cap-sdio-irq;
      cap-sd-highspeed;
      sd-uhs-sdr12;
      sd-uhs-sdr25;
      sd-uhs-sdr50;
      no-mmc;
      status = "ok";
    };
```

## Documentation/devicetree/bindings/mtd/phytium,localbus.yaml
```yaml
# SPDX-License-Identifier: (GPL-2.0-only OR BSD-2-Clause)
%YAML 1.2
---
$id: http://devicetree.org/schemas/mtd/phytium,localbus.yaml#
$schema: http://devicetree.org/meta-schemas/core.yaml#

title: Phytium Localbus controller

maintainers:
        - Wang Hanmo <wanghanmo@phytium.com.cn>

properties:
        compatible:
                const: phytium,localbus

        reg:
                minitem: 2
                description: first contains the register location and length,
                             second contains the memory mapping address and length.

        reg-names:
                minitem: 2
                description: localbus,configuration registers address space,
                             lbc_mm, memory mapped address space.

required:
        - compatible
        - reg
        - reg-names

examples:
        - |
                lbc: localbus@28003000 {
                        compatible = "phytium,localbus";
                        #address-cells = <2>;
                        #size-cells = <1>;
                        reg = <0x00 0x28003000 0x00 0x1000 0x01 0x10000000 0x0 0x10000000>;
                        reg-names = "localbus", "lbc_mm";
                        status = "disabled";
                        norflash@0 {
                                device-type = <1>;
                                device-time-seq = <0x0003 0x043043 0x3f1f01 0x3fc40f>;
                                device-size = <0x10000000>;
                                bank-width = <2>;
                        };
                };
```

## Documentation/devicetree/bindings/net/phytmac.yaml
```yaml
# SPDX-License-Identifier: (GPL-2.0-only OR BSD-2-Clause)
%YAML 1.2
---
$id: http://devicetree.org/schemas/net/phytmac.yaml#
$schema: http://devicetree.org/meta-schemas/core.yaml#

title: Phytium Ethernet MAC controller

maintainers:
  - Wenting Song <songwenting@phytium.com.cn>

allOf:
  - $ref: ethernet-controller.yaml#

properties:
  compatible:
    enum:
      - phytium,gmac-1.0
      - phytium,gmac-2.0

  reg:
    minItems: 1
    maxItems: 3

  interrupts:
    minItems: 1
    maxItems: 8

  queue-number:
    $ref: /schemas/types.yaml#/definitions/uint32
    minimum: 1
    maximum: 8
    description: Number of hardware queues enabled for the controller.

  phy-mode: true

  fixed-link: true

  dma-coherent: true

  dma-burst-length:
    $ref: /schemas/types.yaml#/definitions/uint32

  jumbo-max-length:
    $ref: /schemas/types.yaml#/definitions/uint32

  lpi:
    $ref: /schemas/types.yaml#/definitions/flag
    description: Enable low power idle support.

  magic-packet:
    $ref: /schemas/types.yaml#/definitions/flag
    description: Enable Wake-on-LAN using magic packets.

  use-ncsi:
    $ref: /schemas/types.yaml#/definitions/flag

  use-mii:
    $ref: /schemas/types.yaml#/definitions/flag

required:
  - compatible
  - reg
  - interrupts
  - queue-number
  - phy-mode

unevaluatedProperties: false

examples:
  - |
    ethernet@36ce0000 {
        compatible = "phytium,gmac-1.0";
        reg = <0x36ce0000 0x2000>;
        interrupts = <32 4>, <33 4>, <34 4>, <35 4>;
        queue-number = <4>;
        magic-packet;
        dma-coherent;
        phy-mode = "usxgmii";

        fixed-link {
            speed = <10000>;
            full-duplex;
        };
    };
...
```

## Documentation/devicetree/bindings/pci/phytium,pe2201-pcie-ep.yaml
```yaml
# SPDX-License-Identifier: (GPL-2.0-only OR BSD-2-Clause)
%YAML 1.2
---
$id: http://devicetree.org/schemas/pci/phytium,pe2201-pcie-ep.yaml#
$schema: http://devicetree.org/meta-schemas/core.yaml#

title: Phytium PCIe endpoint controller

maintainers:
  - Li Tongfeng <litongfeng1497@phytium.com.cn>

allOf:
  - $ref: "pci-ep.yaml#"

properties:
  compatible:
    const: phytium,pe2201-pcie-ep

  reg:
    maxItems: 2

  reg-names:
    items:
      - const: reg
      - const: mem

required:
  - compatible
  - reg
  - reg-names

examples:
  - |
    ep0: ep@0x31000000 {
      compatible = "phytium,pe2201-pcie-ep";
      interrupts = <0x00000000 0x0000000a 0x00000004 0x00000000 0x0000000b 0x00000004>;
      reg = <0x00000000 0x31000000 0x00000000 0x00010000 0x00000011 0x00000000 0x00000001 0x00000000 0x00000000 0x31100000 0x00000000 0x00001000>;
      reg-names = "reg", "mem", "hpb";
      max-outbound-regions = <0x00000003>;
      max-functions = [02];
      status = "disabled";
    };
```
