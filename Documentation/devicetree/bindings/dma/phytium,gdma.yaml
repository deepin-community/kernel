## arch/arm64/kernel/haoc/Kconfig
```kconfig
# SPDX-License-Identifier: GPL-2.0
#
# Hardware assisted os compartmentalization(Haoc) configuration
#
menu "Hardware Assisted OS Compartmentalization(HAOC)"

config IEE
	bool "Isolated Execution Environment Framework(IEE)"
	depends on ARM64_4K_PAGES
	depends on ARM64_VA_BITS_48
	help
		Support for Isolated Execution Environment Framework. Foundation of HAOC.
		Could isolate kernel critical data and enforce all write access made and
		verified in IEE APIs.
		Needs hardware support FEAT_HPDS.

config IEE_ALLOW_SPLIT_LM
	bool "Allow IEE split linear mapping"
	depends on IEE
	def_bool n
	help
		Allow the IEE initialization path to split arm64 linear-map block
		mappings when a protected range cannot be described safely at the
		current table level. This is mainly useful for bring-up on layouts
		where protected code or data crosses an existing block boundary.

config IEE_DEBUG
	bool "Skip IEE stack switch for debug"
	depends on IEE
	def_bool n
	help
		Build the arm64 IEE gate with a debug path that skips the IEE stack
		switch and clears HPD before reporting bad gate state. This keeps
		early gate failures easier to inspect while debugging IEE bring-up
		code, and should remain disabled for normal kernels.

config IEE_PTRP
	bool "Pointer Protection for IEE(IEE_PTRP)"
	depends on IEE
	help
		Enable task_token pointer protection for IEE. When the write-only
		sub-option IEE_PTRP_W is disabled, both read and write checks are
		active. When IEE_PTRP_W is enabled, only write protection is active.

config IEE_PTRP_W
	bool "Pointer Write-Only Protection for IEE to improve performance.(IEE_PTRP_W)"
	depends on IEE_PTRP
	help
		Compared to IEE_PTRP, this option only performs write protection on pointers.
		Enabling this option improves performance and reduces the protection surface.
		Disable this option when read-side pointer verification is also required.
		Use the full IEE_PTRP mode when both read and write checks are needed.

config IEE_CYCLE_CHECK
	bool "Cycle check all process cred struct.(IEE_CYCLE_CHECK)"
	depends on IEE_PTRP && !IEE_PTRP_W && CREDP
	def_bool y
	help
		Perform periodic read protection checks on all processes. This mode
		scans task credentials while pointer write-only protection is disabled.
		It is enabled by default when credential protection can use read checks.
		Disable pointer write-only protection to keep this periodic scan active.

config IEE_CS_CHECK
	bool "Context-Switch check cred struct.(CONFIG_IEE_CS_CHECK)"
	depends on IEE_PTRP && !IEE_PTRP_W && CREDP
	def_bool y
	help
		Perform read protection checks on processes during context switching.
		This mode validates task credentials at context-switch boundaries.
		It is enabled by default when credential protection can use read checks.
		Disable pointer write-only protection to keep context-switch checks active.

config IEE_IO_CHECK
	bool "IO check cred struct.(CONFIG_IEE_IO_CHECK)"
	depends on IEE_PTRP && !IEE_PTRP_W && CREDP
	def_bool n
	help
		Perform read protection checks on the process during I/O operations.
		This mode validates task credentials when selected I/O paths run.
		It is disabled by default and can be enabled for additional coverage.
		Disable pointer write-only protection before enabling this read check.

config IEE_SIP
	bool "Sensitive Instruction Protection for IEE(IEE_SIP)"
	depends on IEE
	help
		Protects critical instructions that may break the isolation of IEE,
		such as writing system control registers. These instructions would
		be executated inside IEE.

config CREDP
	bool "Struct cred protection(CREDP)"
	depends on IEE
	help
		Protects kernel struct cred. All modifications of cred must be made and
		verified by IEE APIs, and critical dereferences of cred would be monitored
		by IEE either.
		If unsure, say N.

config PTP
	bool "Page Table Protection(PTP)"
	depends on IEE
	help
		Protect page tables by routing page-table modification paths
		through the IEE gate. This keeps page table updates mediated by
		the isolated execution environment instead of allowing direct
		writes from normal kernel code.

config PTP_RESERVE_ORDER
	int "maximum allowable 2^PTP_RESERVE_ORDER pages for one level page table"
	depends on PTP
	range 9 15
	default 12

config KEYP
	bool "Struct Key protection(KEYP)"
	depends on IEE
	help
		This option enables protection for the kernel's struct key. All modifications
		of keys must be made and verified by IEE APIs to defend memory corruptions.

		If unsure, say N.

config IEE_SELINUX_P
	bool "SELinux Protection(IEE_SELINUX_P)"
	help
		Simple enhancement of the famous linux security module SELinux by putting
		several critical data, like selinux policy, into the IEE region.

		If unsure, say N.
	depends on SECURITY_SELINUX
	depends on IEE
endmenu # HAOC
```

## arch/x86/Kconfig.fpu
```kconfig
# SPDX-License-Identifier: GPL-2.0

menuconfig USING_FPU_IN_KERNEL_NONATOMIC
	bool "Hygon large memory copy support"
	depends on X86_64 && CPU_SUP_HYGON
	default y
	help
	  This option enables support for optimized large memory copy operations
	  on Hygon processors in the kernel space using SSE2 or AVX2 non-temporal (NT)
	  copy instructions. NT instructions are streaming store instructions that bypass
	  the on-chip cache and send data directly to a write-combining buffer.

	  When this option is enabled, you can choose the specific instruction set to use
	  for large memory copy: SSE2 or AVX2. Using these instruction sets can improve data
	  throughput and reduce the number of cache misses during memory copy operations.

if USING_FPU_IN_KERNEL_NONATOMIC

choice
	prompt "X86_HYGON_LMC"
	depends on X86_64 && CPU_SUP_HYGON
	default X86_HYGON_LMC_AVX2_ON
	help
	  Select the type of non-temporal (NT) copy instructions to use for
	  large memory copy operations between kernel and user mode. You can
	  choose between SSE2 or AVX2 instructions based on the processor
	  capabilities and the size of the memory being copied.

	  To use this feature, you also need to configure the data copy size.
	  The file is in `/sys/c86_features/hygon_c86/nt_cpy_mini_len`. Please
	  refer to configuration 4096 and above.

config X86_HYGON_LMC_SSE2_ON
	bool "Using sse2 nt copy for large memory copy"
	help
	  When this feature is enabled, the kernel will use the
	  copy_user_sse2_opt_string function for large memory copy operations.

	  SSE2 (Streaming SIMD Extensions 2) instructions support non-temporal
	  (NT) stores that bypass the CPU cache and write data directly to
	  memory. This can improve performance for large memory copies by reducing
	  cache pollution and taking advantage of the write-combining buffer.

	  However, using SSE2 NT copy may require saving and restoring MMX and
	  SSE2 register contexts during thread switching if an interruption occurs.

config X86_HYGON_LMC_AVX2_ON
	bool "Using avx2 nt copy for large memory copy"
	help
	  When this feature is enabled, the kernel will use the
	  copy_user_avx2_pf64_nt_string function for large memory copy operations.

	  AVX2 (Advanced Vector Extensions 2) instructions provide enhanced
	  vector processing capabilities and support for non-temporal (NT) stores,
	  which can significantly improve memory copy performance for large blocks
	  of data. By bypassing the cache and writing data directly to memory,
	  AVX2 NT copy can achieve higher throughput than SSE2 NT copy.

	  Similar to SSE2, using AVX2 NT copy may require saving and restoring
	  AVX2 register contexts if an interruption occurs during large memory
	  copying, to ensure the process continues smoothly after resuming.

endchoice
endif
```

## drivers/clk/cix/Kconfig
```kconfig
# SPDX-License-Identifier: GPL-2.0
# Common clock support for Cixtech SoC family
menu "Clock support for Cixtech"

comment "Clock options for Cixtech CPUs:"

config COMMON_CLK_CIX
	tristate "Support for Cix's clock controllers"
	select REGMAP_MMIO
	select RESET_CONTROLLER
	depends on ARM64 || COMPILE_TEST
	help
	  Say y here to enable common clock controller for Cix platforms.

endmenu
```

## drivers/crypto/loongson/Kconfig
```kconfig
config CRYPTO_DEV_LOONGSON_HASH
	tristate "Support for Loongson hash Driver"
	depends on MFD_LOONGSON_SE
	select CRYPTO_SM3_GENERIC
	help
	  Support for Loongson hash Driver.
	  If you want to make Loongson hash support available, say Yes and
	  it will be accessible from within Linux. To compile this
	  driver as a module, choose M here; the module will be called
	  loongson_hash.

config CRYPTO_DEV_LOONGSON_RNG
	tristate "Support for Loongson RNG Driver"
	depends on MFD_LOONGSON_SE
	help
	  Support for Loongson RNG Driver.
	  If you want to make Loongson rng support available, say Yes and
	  it will be accessible from within Linux. To compile this
	  driver as a module, choose M here; the module will be called
	  loongson_rng.

config CRYPTO_DEV_LOONGSON_SKCIPHER
	tristate "Support for Loongson skcipher Driver"
	depends on MFD_LOONGSON_SE
	select CRYPTO_SM4_GENERIC
	help
	  Support for Loongson skcipher Driver.
	  If you want to make Loongson hash support available, say Yes and
	  it will be accessible from within Linux. To compile this
	  driver as a module, choose M here; the module will be called
	  loongson_skcipher.
```

## drivers/crypto/westone/Kconfig
```kconfig
#
# Westone crypto drivers configuration
#
config CRYPTO_DEV_WESTONE
	tristate "Westone cryptographic engine driver"
	depends on LOONGARCH
	help
	  If you have a wst security chip,
	  say Yes and it will be accessible from within Linux.
	  To compile this driver as a module, choose M here;
	  If unsure, say N.
```

## drivers/dma-buf/heaps/Kconfig
```kconfig
config DMABUF_HEAPS_SYSTEM
	bool "DMA-BUF System Heap"
	depends on DMABUF_HEAPS
	help
	  Choose this option to enable the system dmabuf heap. The system heap
	  is backed by pages from the buddy allocator. If in doubt, say Y.

config DMABUF_HEAPS_CMA
	bool "DMA-BUF CMA Heap"
	depends on DMABUF_HEAPS && DMA_CMA
	help
	  Choose this option to enable dma-buf CMA heap. This heap is backed
	  by the Contiguous Memory Allocator (CMA). If your system has these
	  regions, you should say Y here.

config DMABUF_HEAPS_NPU_SYSTEM
	bool "DMA-BUF for Phytium NPU system Heap"
	depends on DMABUF_HEAPS && ARCH_PHYTIUM
	help
	  Choose this option to enable a new dma-buf system heap for the
	  Phytium's NPU. The npu system heap is backed by pages from the buddy
	  allocator. If your system has NPU driver, you should say Y here.
```

## drivers/i2c/busses/phytium_i2c_v2/Kconfig
```kconfig
# SPDX-License-Identifier: GPL-2.0-only
#
# Sensor device configuration
#

config I2C_V2_PLATFORM
	tristate "Phytium I2C_V2 Platform"
	depends on (ACPI && COMMON_CLK) || !ACPI
	select I2C_SMBUS

	help
	  If you say yes to this option, support will be included for the
	  Phytium I2C adapter. Only master mode is supported.

	  This driver can also be built as a module.If so,the module
	  will be called i2c-phytium-v2-platform.
```
