## arch/sw_64/Kconfig.debug
```kconfig
# SPDX-License-Identifier: GPL-2.0
config EARLY_PRINTK
	bool "Early printk" if EXPERT
	depends on SYS_HAS_EARLY_PRINTK
	default y
	help
	  This option enables special console drivers which allow the kernel
	  to print messages very early in the bootup process.

	  This is useful for kernel debugging when your machine crashes very
	  early before the console code is initialized. For normal operation,
	  it is not recommended because it looks ugly on some machines and
	  doesn't cooperate with an X server. You should normally say N here,
	  unless you want to debug such a crash.

config UNA_PRINT
	bool	"Show debug info about user unalign memory access"
	default n

config MATHEMU
	tristate "Kernel FP software completion" if DEBUG_KERNEL && !SMP
	default y if !DEBUG_KERNEL || SMP
	help
	  This option is required for IEEE compliant floating point arithmetic
	  on the SW. The only time you would ever not say Y is to say M in
	  order to debug the code. Say Y unless you know what you are doing.

config STACKTRACE_SUPPORT
        bool
        default y

config SW64_RRU
	bool "Enable RRU(Remote Read User)"
	depends on SW64
	default n
	help
	  Duplicate user stdout and stderr to specific space.
	  Do not enable it in a production kernel.

config SW64_RRK
	bool "Enable RRK(Remote Read Kernel)"
	depends on SW64
	default y
	help
	  Duplicate kernel log to specific space.
	  Do not enable it in a production kernel.

config DEBUG_MATCH
	bool "instruction-flow and data-flow match debugfs interface"
	depends on DEBUG_FS && SUBARCH_C4
	default n
	help
	  Turns on the DebugFS interface for instruction-flow and data-flow match.
```
