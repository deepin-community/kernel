## Documentation/devicetree/bindings/spi/phytium,qspi-nor.yaml
```yaml
# SPDX-License-Identifier: (GPL-2.0-only OR BSD-2-Clause)
%YAML 1.2
---
$id: http://devicetree.org/schemas/spi/phytium,qspi-nor.yaml#
$schema: http://devicetree.org/schemas/meta-schemas/core.yaml#

title: Phytium Quad Serial Peripheral Interface (QSPI) bindings

maintainers:
  - Chen Baozi <chenbaozi@phytium.com.cn>

allOf:
  - $ref: "spi-controller.yaml#"

properties:
  compatible:
    const: phytium,qspi-nor

  reg:
    items:
      - description: registers
      - description: memory mapping region

  reg-names:
    items:
      - const: qspi
      - const: qspi_mm

  clocks:
    maxItems: 1

  no-direct-mapping:
    $ref: /schemas/types.yaml#/definitions/flag
    description:
      Indicates if we can use direct mapping to access the flash

required:
  - compatible
  - reg
  - reg-names
  - clocks

unevaluateProperties: false

examples:
  - |
    qspi: qspi@28014000 {
      compatible = "phytium,qspi-nor";
      reg = <0x0 0x28014000 0x0     0x1000>,
            <0x0        0x0 0x0 0x02000000>;
      reg-names = "qspi", "qspi_mm";
      clocks = <&sysclk_600mhz>;

      #address-cells = <1>;
      #size-cells = <0>;

      flash@0 {
        compatible = "jedec,spi-nor";
        reg = <0>;
        spi-rx-bus-width = <4>;
        spi-max-frequency = <600000000>;
      };

      flash@1 {
        compatible = "jedec,spi-nor";
        reg = <1>;
        spi-rx-bus-width = <4>;
        spi-max-frequency = <600000000>;
      };
    };
```

## Documentation/devicetree/bindings/usb/phytium,usb2.yaml
```yaml
# SPDX-License-Identifier: GPL-2.0-only OR BSD-2-Clause
%YAML 1.2
---
$id: http://devicetree.org/schemas/usb/phytium,usb2.yaml#
$schema: http://devicetree.org/meta-schemas/core.yaml#

title: Phytium USBHS-DRD controller bindings

maintainers:
  - Chen Baozi <chenbaozi@phytium.com>

properties:
  compatible:
    const: phytium,usb2

  reg:
    items:
      - description: USB controller registers
      - description: PHY registers

  interrupts:
    maxItems: 1

  dr_mode:
    enum: [host, otg, peripheral]

required:
  - compatible
  - reg
  - interrupts

additionalProperties: false

examples:
  - |
    usb2_0: usb2@31800000 {
      compatible = "phytium,usb2";
      reg = <0x0 0x31800000 0x0 0x80000>,
            <0x0 0x31990000 0x0 0x10000>;
      interrupts = <GIC_SPI 32 IRQ_TYPE_LEVEL_HIGH>;
    };
```

## Documentation/devicetree/bindings/w1/phytium,w1.yaml
```yaml
# SPDX-License-Identifier: (GPL-2.0-only OR BSD-2-Clause)
%YAML 1.2
---
$id: http://devicetree.org/schemas/w1/phytium,w1.yaml#
$schema: http://devicetree.org/meta-schemas/core.yaml#

title: Phytium 1-wire bus master controller

maintainers:
  - Chen Baozi <chenbaozi@phytium.com.cn>

properties:
  compatible:
    const: phytium,w1

  reg:
    maxItems: 1

  interrupts:
    maxItems: 1

required:
  - compatible
  - reg
  - interrupts

examples:
  - |
    onewire0: onewire@2803f000 {
      compatible = "phytium,w1";
      reg = <0x0 0x2803f000 0x0 0x1000>;
      interrupts = <GIC_SPI 166 IRQ_TYPE_LEVEL_HIGH>;
    };
```
