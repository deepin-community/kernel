## arch/sw_64/crypto/Kconfig
```kconfig
# SPDX-License-Identifier: GPL-2.0

menu "Accelerated Cryptographic Algorithms for CPU (SW64)"

config CRYPTO_CRC32_SW64
	tristate "CRC32c and CRC32"
	depends on SW64 && !SUBARCH_C3B
	select CRC32
	select CRYPTO_HASH
	help
	  CRC32c and CRC32 CRC algorithms

	  Architecture: SW64 with CRC32 instructions

endmenu
```

## arch/sw_64/kvm/Kconfig
```kconfig
# SPDX-License-Identifier: GPL-2.0
#
# KVM configuration
#
source "virt/kvm/Kconfig"

menuconfig VIRTUALIZATION
	bool "Virtualization"
	help
	  Say Y here to get to see options for using your Linux host to run
	  other operating systems inside virtual machines (guests).
	  This option alone does not add any kernel code.

	  If you say N, all options in this submenu will be skipped and disabled.

if VIRTUALIZATION

config KVM
	tristate "Kernel-based Virtual Machine (KVM) support"
	select PREEMPT_NOTIFIERS
	select CMA
	depends on NET
	select HAVE_KVM_EVENTFD
	select HAVE_KVM_IRQCHIP
	select HAVE_KVM_IRQ_ROUTING
	select HAVE_KVM_IRQFD
	select HAVE_KVM_MSI
	select KVM_VFIO
	select MMU_NOTIFIER
	select KVM_GENERIC_DIRTYLOG_READ_PROTECT
	select TUN
	select GENERIC_ALLOCATOR
	select KVM_GENERIC_DIRTYLOG_READ_PROTECT
	select HAVE_KVM_DIRTY_RING_ACQ_REL
	help
	  Support for hosting Guest kernels.
	  We don't support KVM with 3-level page tables yet.

	  If unsure, say N.

source "drivers/vhost/Kconfig"

endif # VIRTUALIZATION
```

## arch/sw_64/lib/Kconfig
```kconfig
# SPDX-License-Identifier: GPL-2.0
menu "Library optimization options"

config DEEP_CLEAR_PAGE
	bool "Clear Page with SIMD optimization"
	default y
	help
	  This option enables the use of SIMD version of clear page routine.
	  Say N if you want to use the generic version.

config DEEP_CLEAR_USER
	bool "Clear User with SIMD optimization"
	default y
	help
	  This option enables the use of SIMD version of clear user routine.
	  Say N if you want to use the generic version.

config DEEP_COPY_PAGE
	bool "Copy Page with SIMD optimization"
	default y
	help
	  This option enables the use of SIMD version of copy page routine.
	  Say N if you want to use the generic version.

config DEEP_COPY_USER
	bool "Copy User with SIMD optimization"
	default y
	help
	  This option enables the use of SIMD version of copy user routine.
	  Say N if you want to use the generic version.


config DEEP_MEMCPY
	bool "Memory Copy with SIMD optimization"
	default y
	help
	  This option enables the use of SIMD version of memory copy routine.
	  Say N if you want to use the generic version.

config DEEP_MEMSET
	bool "Memory Set with SIMD optimization"
	default y
	help
	  This option enables the use of SIMD version of memory set routine.
	  Say N if you want to use the generic version.

endmenu
```

## arch/sw_64/mm/Kconfig
```kconfig
choice
	prompt "Virtual address space size"
	default SW64_VA_BITS_47
	help
	 Allows choosing one of multiple possible userspace virtual address space size.

config SW64_VA_BITS_47
	bool "47-bit"
	help
	  Limit the userspace VAs to 47-bit size.

	  It may waste some userspace VA range, but is safe and enough for current
	  userland to works wells.

config SW64_VA_BITS_52
	bool "52-bit"
	help
	  Use the full 52-bit size userspace VAs.

	  The kernel will attempt to maintain compatibility with older software by
	  providing 47-bit VAs unless a hint is supplied to mmap.

endchoice

config SW64_VA_BITS
	int
	default 47 if SW64_VA_BITS_47
	default 52 if SW64_VA_BITS_52
	default 47
	help
	  The size of userspace VA.

config SW64_FORCE_52BIT
	bool "Force 52-bit virtual address for userspace"
	depends on SW64_VA_BITS_52 && EXPERT
	help
	  This configuration option disable the 47-bit compatibility logic, and forces
	  all userspace address to be 52-bit if possible.

	  Note, it is not 100% safe for software that unable to handle VA bigger than
	  47-bit to works well with this option enabled. Do not enable it for now.
```

## drivers/char/phytnetled/Kconfig
```kconfig
# SPDX-License-Identifier: GPL-2.0-only
#
# PCMCIA character device configuration
#
config PHYTNET_LED
        tristate "Phytium mac led control module"
        depends on PHYTMAC
        depends on GPIO_PHYTIUM_PLAT
        default m
        help
          If you have a network (Ethernet) controller of this type and
          want to use it control port led say Y or M here.
```

## drivers/cpuidle/Kconfig.sw64
```kconfig
# SPDX-License-Identifier: GPL-2.0-only
#
# SW64 CPU Idle drivers
#
config SW64_CPUIDLE
	bool "Generic SW64 CPU idle Driver"
	depends on !NO_HZ
	depends on !NO_HZ_IDLE
	help
	  Enable cpuidle support for SW64 architecture.
	  Disabled when tickless system (NO_HZ or NO_HZ_IDLE) is active.
```

## drivers/crypto/montage/Kconfig
```kconfig
# SPDX-License-Identifier: GPL-2.0

source "drivers/crypto/montage/tsse/Kconfig"
```

## drivers/crypto/montage/tsse/Kconfig
```kconfig
# SPDX-License-Identifier: GPL-2.0-only
config CRYPTO_DEV_TSSE
	tristate "Support for Montage(R) TSSE"
	depends on X86 && PCI
	select FW_LOADER
	help
	  Support for Montage(R) TSSE for accelerating crypto workloads.

	  To compile this as a module, choose M here.
```

## drivers/gpu/drm/arise/Kconfig
```kconfig
config DRM_ARISE
	tristate "Arise DRM"
	default m
	depends on ARM || LOONGARCH || MIPS || X86 || COMPILE_TEST
	depends on DRM
	select DRM_KMS_HELPER
	help
	  Choose this option if you have an Glenfly Arise GPU. If M is selected
	  the module will be called arise.
```

## drivers/gpu/drm/gsgpu/gpu/Kconfig
```kconfig
config DRM_GSGPU
	tristate "Loongson Godson GPU"
	depends on DRM && PCI && MMU
	select FW_LOADER
	select DRM_KMS_HELPER
	select DRM_SCHED
	select DRM_TTM
	select DRM_TTM_HELPER
	select DRM_BUDDY
	select POWER_SUPPLY
	select HWMON
	select BACKLIGHT_CLASS_DEVICE
	select BACKLIGHT_LCD_SUPPORT
	select INTERVAL_TREE
	select CHASH
	help
	  Choose this option if your system has a Godson LG100 graphics processing
	  unit, such as those found in the Loongson 7A2000 bridge chips.

	  If M is selected, the module will be called gsgpu.

config DRM_GSGPU_USERPTR
	bool "Always enable userptr write support"
	depends on DRM_GSGPU
	select MMU_NOTIFIER
	select HMM_MIRROR
	default y
	help
	  This option selects CONFIG_MMU_NOTIFIER and CONFIG_HMM_MIRROR if it
	  isn't already selected to enabled full userptr support.

config DRM_GSGPU_GART_DEBUGFS
	bool "Allow GART access through debugfs"
	depends on DRM_GSGPU
	depends on DEBUG_FS
	default n
	help
	  Selecting this option creates a debugfs file to inspect the mapped
	  pages. Uses more memory for housekeeping, enable only for debugging.
```

## drivers/gpu/drm/inspur/Kconfig
```kconfig
# License: GPL-2.0
#
# inspur drm device configuration.

source "drivers/gpu/drm/inspur/inspur-drm/Kconfig"
```

## drivers/gpu/drm/inspur/inspur-drm/Kconfig
```kconfig
config DRM_INSPUR
    tristate "DRM Support for Inspur BMC"
    depends on DRM && PCI && MMU
    select DRM_KMS_HELPER
    select DRM_VRAM_HELPER
    help
        Choose this option if you have a Inspur soc chipset.If M is selected the
        module will be called inspur - drm.
```

## drivers/gpu/drm/mwv206/Kconfig
```kconfig
config DRM_MWV206
	tristate "Support for MWV206"
	help
	  Choose this option if you want to enable mwv206 support
	  for Jingjia.
```

## drivers/gpu/drm/mwv207/Kconfig
```kconfig
config DRM_MWV207
	tristate "MWV207 chip"
	depends on DRM && SND_PCM
	select DRM_KMS_HELPER
	select DRM_VRAM_HELPER
	select DRM_TTM
	select DRM_SCHED
	select FB_IOMEM_HELPERS if DRM_FBDEV_EMULATION
	select DRM_GEM_SHMEM_HELPER
	select DRM_DEVFREQ
	select DRM_TTM_HELPER
	help
	  Choose this option if you have a Jingjia graphics card. 
          If M is selected, the module will be called mwv207 (JM9100).
```

## drivers/gpu/drm/phytium/Kconfig
```kconfig
config DRM_PHYTIUM
	tristate "DRM Support for Phytium Graphics Card"
	depends on DRM && ARCH_PHYTIUM
	select DRM_KMS_HELPER
	select DRM_DISPLAY_HELPER
	select DRM_DISPLAY_DP_HELPER
	select DRM_DISPLAY_HDCP_HELPER
	help
	  Choose this option if you have a phytium graphics card.
	  Phytium graphics card include display controller for X100 and E2000 devices.
	  In addition,the driver also supports the display of E2000S BMC.
	  This driver provides kernel mode setting and buffer management to userspace.
```
